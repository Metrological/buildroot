## configs/toolchain_gcc_5.4.0_acn_defconfig
```kconfig
BR2_mipsel=y
# BR2_MIPS_SOFT_FLOAT is not set
BR2_KERNEL_HEADERS_VERSION=y
BR2_DEFAULT_KERNEL_VERSION="3.3.8"
BR2_PACKAGE_HOST_LINUX_HEADERS_CUSTOM_3_3=y
BR2_UCLIBC_VERSION_0_9_32=y
BR2_TOOLCHAIN_BUILDROOT_LARGEFILE=y
BR2_TOOLCHAIN_BUILDROOT_INET_IPV6=y
BR2_TOOLCHAIN_BUILDROOT_INET_RPC=y
BR2_TOOLCHAIN_BUILDROOT_WCHAR=y
BR2_TOOLCHAIN_BUILDROOT_USE_SSP=y
# BR2_UCLIBC_INSTALL_UTILS is not set
BR2_BINUTILS_VERSION_2_29_X=y
BR2_GCC_VERSION_5_X=y
BR2_TOOLCHAIN_BUILDROOT_CXX=y
BR2_GCC_USE_OLD_ABI_BY_DEFAULT=y
BR2_PACKAGE_HOST_BISON=y
BR2_PACKAGE_HOST_FLEX=y
BR2_PACKAGE_HOST_GDB=y
BR2_GDB_VERSION_7_10=y
BR2_INIT_NONE=y
# BR2_PACKAGE_BUSYBOX is not set
# BR2_TARGET_ROOTFS_TAR is not set
```

## configs/toolchain_gcc_5.4.0_hzn_gnu_defconfig
```kconfig
BR2_x86_atom=y
BR2_KERNEL_HEADERS_VERSION=y
BR2_DEFAULT_KERNEL_VERSION="2.6.28"
BR2_TOOLCHAIN_BUILDROOT_GLIBC=y
BR2_TOOLCHAIN_BUILDROOT_GLIBC_VERSION="2.11.3"
BR2_BINUTILS_VERSION_2_24=y
BR2_GCC_VERSION_5_X=y
BR2_TOOLCHAIN_BUILDROOT_CXX=y
BR2_GCC_USE_OLD_ABI_BY_DEFAULT=y
BR2_PACKAGE_HOST_BISON=y
BR2_PACKAGE_HOST_FLEX=y
BR2_PACKAGE_HOST_GDB=y
BR2_GDB_VERSION_7_10=y
BR2_TARGET_OPTIMIZATION=""
BR2_INIT_NONE=y
# BR2_PACKAGE_BUSYBOX is not set
# BR2_TARGET_ROOTFS_TAR is not set
```

## configs/toolchain_gcc_5.4.0_hzn_uclibc_defconfig
```kconfig
BR2_x86_i686=y
BR2_KERNEL_HEADERS_VERSION=y
BR2_DEFAULT_KERNEL_VERSION="2.6.28"
BR2_UCLIBC_VERSION_0_9_30_1=y
BR2_UCLIBC_CONFIG="package/uclibc/uClibc-0.9.30.config"
BR2_TOOLCHAIN_BUILDROOT_LARGEFILE=y
BR2_TOOLCHAIN_BUILDROOT_INET_IPV6=y
BR2_TOOLCHAIN_BUILDROOT_INET_RPC=y
BR2_TOOLCHAIN_BUILDROOT_WCHAR=y
BR2_PTHREADS_OLD=y
BR2_TOOLCHAIN_BUILDROOT_USE_SSP=y
# BR2_UCLIBC_INSTALL_UTILS is not set
BR2_BINUTILS_VERSION_2_24=y
BR2_GCC_VERSION_5_X=y
BR2_TOOLCHAIN_BUILDROOT_CXX=y
BR2_GCC_USE_OLD_ABI_BY_DEFAULT=y
BR2_PACKAGE_HOST_BISON=y
BR2_PACKAGE_HOST_FLEX=y
BR2_PACKAGE_HOST_GDB=y
BR2_GDB_VERSION_7_10=y
BR2_TARGET_OPTIMIZATION=""
BR2_INIT_NONE=y
# BR2_PACKAGE_BUSYBOX is not set
# BR2_TARGET_ROOTFS_TAR is not set
```

## configs/toolchain_gcc_5.4.0_nos_defconfig
```kconfig
BR2_arm=y
BR2_cortex_a7=y
BR2_ARM_EABIHF=y
BR2_ARM_FPU_VFPV3D16=y
BR2_KERNEL_HEADERS_VERSION=y
BR2_DEFAULT_KERNEL_VERSION="3.14.28"
BR2_PACKAGE_HOST_LINUX_HEADERS_CUSTOM_3_14=y
BR2_TOOLCHAIN_BUILDROOT_EGLIBC=y
BR2_TOOLCHAIN_BUILDROOT_LIBC_EXTERNAL=y
BR2_BINUTILS_VERSION_2_29_X=y
BR2_GCC_VERSION_5_X=y
BR2_TOOLCHAIN_BUILDROOT_CXX=y
BR2_GCC_USE_OLD_ABI_BY_DEFAULT=y
BR2_PACKAGE_HOST_BISON=y
BR2_PACKAGE_HOST_FLEX=y
BR2_PACKAGE_HOST_GDB=y
BR2_GDB_VERSION_7_10=y
BR2_INIT_NONE=y
# BR2_PACKAGE_BUSYBOX is not set
# BR2_TARGET_ROOTFS_TAR is not set
```

## configs/x86_debug_defconfig
```kconfig
BR2_x86_64=y
BR2_ENABLE_DEBUG=y
BR2_DEBUG_3=y
BR2_STRIP_none=y
BR2_OPTIMIZE_0=y
BR2_ENABLE_SSP=y
BR2_KERNEL_HEADERS_VERSION=y
BR2_DEFAULT_KERNEL_VERSION="3.18.11"
BR2_TOOLCHAIN_BUILDROOT_EGLIBC=y
BR2_GCC_VERSION_4_8_X=y
BR2_TOOLCHAIN_BUILDROOT_CXX=y
BR2_PACKAGE_HOST_GDB=y
BR2_GDB_VERSION_7_7=y
BR2_ENABLE_LOCALE_PURGE=y
BR2_ENABLE_LOCALE_WHITELIST="C en_US"
BR2_TARGET_GENERIC_HOSTNAME="rpi"
BR2_TARGET_GENERIC_TIMESERVER="ntp.xs4all.nl"
BR2_TARGET_GENERIC_ISSUE=""
BR2_ROOTFS_DEVICE_CREATION_DYNAMIC_UDEV=y
BR2_TARGET_GENERIC_ROOT_PASSWD="root"
BR2_TARGET_GENERIC_GETTY_PORT="tty1"
BR2_TARGET_GENERIC_GETTY_TERM=""
BR2_LINUX_KERNEL=y
BR2_LINUX_KERNEL_CUSTOM_GIT=y
BR2_LINUX_KERNEL_CUSTOM_REPO_URL="https://github.com/raspberrypi/linux.git"
BR2_LINUX_KERNEL_CUSTOM_REPO_VERSION="8362c08dfc8dd9e54745b3f1e5e4ff0a1fb30614"
BR2_LINUX_KERNEL_DEFCONFIG="x86_64"
BR2_PACKAGE_BUSYBOX_SMP=y
BR2_PACKAGE_GDB=y
BR2_PACKAGE_GDB_SERVER=y
BR2_PACKAGE_GDB_DEBUGGER=y
BR2_PACKAGE_VALGRIND=y
BR2_PACKAGE_VALGRIND_SGCHECK=y
BR2_PACKAGE_VALGRIND_BBV=y
BR2_PACKAGE_VALGRIND_LACKEY=y
BR2_PACKAGE_VALGRIND_NULGRIND=y
BR2_PACKAGE_QTBROWSER=y
BR2_PACKAGE_QT5=y
BR2_PACKAGE_QT5BASE_LICENSE_APPROVED=y
BR2_PACKAGE_QT5BASE_XCB=y
BR2_PACKAGE_QT5BASE_EGLFS=y
BR2_PACKAGE_QT5BASE_FONTCONFIG=y
BR2_PACKAGE_QT5WEBKIT=y
BR2_PACKAGE_XORG7=y
BR2_PACKAGE_XSERVER_XORG_SERVER=y
BR2_PACKAGE_XSERVER_XORG_SERVER_MODULAR=y
BR2_PACKAGE_MESA3D=y
BR2_PACKAGE_XDRIVER_XF86_VIDEO_VMWARE=y
BR2_PACKAGE_UDEV_RULES_GEN=y
BR2_PACKAGE_PORTAUDIO=y
BR2_PACKAGE_TREMOR=y
BR2_PACKAGE_OPENSSL=y
BR2_PACKAGE_GRAPHITE2=y
BR2_PACKAGE_HARFBUZZ=y
BR2_PACKAGE_JPEG=y
BR2_PACKAGE_JPEG_TURBO=y
BR2_PACKAGE_LIBMNG=y
BR2_PACKAGE_LIBPNG=y
BR2_PACKAGE_WEBP=y
BR2_PACKAGE_LIBCEC=y
BR2_PACKAGE_LIBXKBCOMMON=y
BR2_PACKAGE_LIBMMS=y
BR2_PACKAGE_C_ARES=y
BR2_PACKAGE_LIBCURL=y
BR2_PACKAGE_LIBSOUP=y
BR2_PACKAGE_LIBSOUP_SSL=y
BR2_PACKAGE_BOOST=y
BR2_PACKAGE_BOOST_PROGRAM_OPTIONS=y
BR2_PACKAGE_BOOST_SYSTEM=y
BR2_PACKAGE_BOOST_THREAD=y
BR2_PACKAGE_CPPSDK=y
BR2_PACKAGE_CPPSDK_DEBUG=y
BR2_PACKAGE_CPPSDK_GENERICS=y
BR2_PACKAGE_LOG4CPLUS=y
BR2_PACKAGE_SHARED_MIME_INFO=y
BR2_PACKAGE_DROPBEAR=y
BR2_PACKAGE_DROPBEAR_DISABLE_REVERSEDNS=y
BR2_PACKAGE_GESFTPSERVER=y
BR2_PACKAGE_DDPSTUB=y
```

## configs/x86_nrd_defconfig
```kconfig
BR2_x86_pentiumpro=y
BR2_KERNEL_HEADERS_VERSION=y
BR2_DEFAULT_KERNEL_VERSION="3.12.5"
BR2_TOOLCHAIN_BUILDROOT_LARGEFILE=y
BR2_TOOLCHAIN_BUILDROOT_INET_IPV6=y
BR2_TOOLCHAIN_BUILDROOT_CXX=y
BR2_TARGET_GENERIC_GETTY_PORT="tty1"
BR2_LINUX_KERNEL=y
BR2_LINUX_KERNEL_CUSTOM_VERSION=y
BR2_LINUX_KERNEL_CUSTOM_VERSION_VALUE="3.12.5"
BR2_LINUX_KERNEL_USE_CUSTOM_CONFIG=y
BR2_LINUX_KERNEL_CUSTOM_CONFIG_FILE="board/qemu/x86/linux-3.12.config"
BR2_PACKAGE_FFMPEG_GPL=y
BR2_PACKAGE_FFMPEG_NONFREE=y
# BR2_PACKAGE_FFMPEG_FFMPEG is not set
BR2_PACKAGE_FFMPEG_SWSCALE=y
BR2_PACKAGE_NRD=y
BR2_PACKAGE_DXDRM=y
BR2_PACKAGE_DIRECTFB=y
BR2_PACKAGE_DIRECTFB_ATI128=y
BR2_PACKAGE_DIRECTFB_MATROX=y
BR2_PACKAGE_DIRECTFB_I830=y
BR2_PACKAGE_DIRECTFB_IMLIB2=y
BR2_PACKAGE_DIRECTFB_DITHER_RGB16=y
BR2_PACKAGE_PORTAUDIO_OSS=y
BR2_PACKAGE_PORTAUDIO_CXX=y
BR2_TARGET_ROOTFS_EXT2=y
# BR2_TARGET_ROOTFS_TAR is not set
```

## package/apitrace/Config.in
```kconfig
comment "apitrace needs a (e)glibc toolchain w/ C++"
	depends on !BR2_INSTALL_LIBSTDCPP || !BR2_TOOLCHAIN_USES_GLIBC

config BR2_PACKAGE_APITRACE
	bool "apitrace"
	depends on BR2_INSTALL_LIBSTDCPP
	depends on BR2_TOOLCHAIN_USES_GLIBC # uses glibc specific __libc_dlsym
	help
	  Trace and replay OpenGL and OpenGL ES APIs calls to/from a
	  file. You may install apitrace GUI from your distribution to
	  inspect generated traces.

	  http://apitrace.github.io/

menu "Extra options"

config BR2_PACKAGE_APITRACE_GUI
	bool  "apitrace GUI (experimental feature)"
	help
	  "Apitrace GUI can be used to analyse the trace files generated by apitrace"
	depends on BR2_PACKAGE_APITRACE && BR2_PACKAGE_QT5WEBKIT

comment "Apitrace GUI depends on apitrace and qt5webkit"
	depends on !BR2_PACKAGE_APITRACE || !BR2_PACKAGE_QT5WEBKIT

endmenu
```

## package/athol/Config.in
```kconfig
config BR2_PACKAGE_ATHOL
	bool "athol"
	depends on BR2_PACKAGE_WAYLAND
	depends on BR2_PACKAGE_WPE
	help
      Here be dragons.
```

## package/bcm-refsw/Config.in
```kconfig
config BR2_PACKAGE_BCM_REFSW
	bool "bcm-refsw"
	depends on BR2_mipsel || BR2_arm
	depends on BR2_INSTALL_LIBSTDCPP
	depends on BR2_TOOLCHAIN_HAS_THREADS
	select BR2_PACKAGE_HAS_OPENGL_EGL
	select BR2_PACKAGE_HAS_OPENGL_ES
	help
	  bcm-refsw

if BR2_PACKAGE_BCM_REFSW

config BR2_PACKAGE_PROVIDES_OPENGL_EGL
	default "bcm-refsw"

config BR2_PACKAGE_PROVIDES_OPENGL_ES
	default "bcm-refsw"

config BR2_BCMREFSW_PROXY_MODE
	bool "proxy"
	help
	  In ProxyMode, the Broadcom Reference software is build i such a way that most of
	  the functionality is placed in kermnel modules. This means that the client lib, 
	  included in the applications is just a proxy towards the kernel module.
	  if enabled, NEXUS_MODE=proxy.

config BR2_PACKAGE_BCM_REFSW_EGLCUBE
	bool "eglcube"
	default n
	help
	  Build the EGL cube example, just for test and fun.

endif
```

## package/binutils/Config.in.host
```kconfig
comment "Binutils Options"

choice
	prompt "Binutils Version"
	depends on !BR2_arc
	default BR2_BINUTILS_VERSION_2_26_X
	help
	  Select the version of binutils you wish to use.

	config BR2_BINUTILS_VERSION_2_18_AVR32_1_0_1
		depends on BR2_avr32
		bool "binutils 2.18-avr32-1.0.1"

	config BR2_BINUTILS_VERSION_2_20_1
		depends on !BR2_avr32
		depends on !BR2_ARM_EABIHF
		bool "binutils 2.20.1"

	config BR2_BINUTILS_VERSION_2_21
		depends on !BR2_avr32
		depends on !BR2_ARM_EABIHF
		bool "binutils 2.21"

	config BR2_BINUTILS_VERSION_2_21_1
		depends on !BR2_avr32
		depends on !BR2_ARM_EABIHF
		bool "binutils 2.21.1"

	config BR2_BINUTILS_VERSION_2_22
		depends on !BR2_avr32
		bool "binutils 2.22"

	config BR2_BINUTILS_VERSION_2_23_1
		depends on !BR2_avr32
		bool "binutils 2.23.1"

	config BR2_BINUTILS_VERSION_2_23_2
		depends on !BR2_avr32
		bool "binutils 2.23.2"

	config BR2_BINUTILS_VERSION_2_24
		depends on !BR2_avr32
		bool "binutils 2.24"

	config BR2_BINUTILS_VERSION_2_25
		depends on !BR2_avr32
		bool "binutils 2.25"

	config BR2_BINUTILS_VERSION_2_25_X
		bool "binutils 2.25.1"
		# supported but broken on Blackfin
		depends on !BR2_bfin

	config BR2_BINUTILS_VERSION_2_26_X
		bool "binutils 2.26.1"

	config BR2_BINUTILS_VERSION_2_27_X
		bool "binutils 2.27"
		# binutils 2.27 triggers a bug in elf2flt on ARM/noMMU
		depends on !(BR2_arm && !BR2_USE_MMU)

	config BR2_BINUTILS_VERSION_2_28_X
		bool "binutils 2.28.1"

	config BR2_BINUTILS_VERSION_2_29_X
		bool "binutils 2.29"
endchoice

config BR2_BINUTILS_VERSION
	string
	default "2.18-avr32-1.0.1" if BR2_BINUTILS_VERSION_2_18_AVR32_1_0_1
	default "8351467c933d277ebea0c8d99ad2b65b5f7b6bc2" if BR2_microblaze
	default "2.20.1"	if BR2_BINUTILS_VERSION_2_20_1
	default "2.21"		if BR2_BINUTILS_VERSION_2_21
	default "2.21.1"	if BR2_BINUTILS_VERSION_2_21_1
	default "2.22"		if BR2_BINUTILS_VERSION_2_22
	default "2.23.1"	if BR2_BINUTILS_VERSION_2_23_1
	default "2.23.2"	if BR2_BINUTILS_VERSION_2_23_2
	default "2.24"		if BR2_BINUTILS_VERSION_2_24
	default "2.25"		if BR2_BINUTILS_VERSION_2_25
	default "arc-2017.03"	if BR2_arc
	default "2.25.1"	if BR2_BINUTILS_VERSION_2_25_X
	default "2.26.1"	if BR2_BINUTILS_VERSION_2_26_X
	default "2.27"		if BR2_BINUTILS_VERSION_2_27_X
	default "2.28.1"	if BR2_BINUTILS_VERSION_2_28_X
	default "2.29"		if BR2_BINUTILS_VERSION_2_29_X

config BR2_BINUTILS_ENABLE_LTO
	bool

config BR2_BINUTILS_EXTRA_CONFIG_OPTIONS
	string "Additional binutils options"
	default ""
	help
	  Any additional binutils options you may want to include.
```

## package/ca-bundle/Config.in
```kconfig
config BR2_PACKAGE_CA_BUNDLE
	bool "ca-bunle"
	select BR2_PACKAGE_OPENSSL
	help
	  Generate CA bundle
```

## package/cloog/Config.in
```kconfig
config BR2_PACKAGE_CLOOG
	bool "cloog"
	select BR2_PACKAGE_GMP
	help
	  CLooG is a free software and library to generate code for scanning
	  Z-polyhedra. That is, it finds a code (e.g. in C, FORTRAN...) that
	  reaches each integral point of one or more parameterized polyhedra.

	  http://www.cloog.org/
```

## package/cppsdk/Config.in
```kconfig
config BR2_PACKAGE_CPPSDK
	bool "cppsdk"
	help
	  Lightweight C++ platform abstraction wrapper classes 
	  to assist C++ developers to build platform abstracted
	  applications. 
	  The library is developped to abstract the Windows OS
	  and the linux OS.
	  Abstractions for Threading, Sockets, Synchronisation,
 	  Web/WebSockets etc..

if BR2_PACKAGE_CPPSDK

config BR2_PACKAGE_CPPSDK_GENERICS
        bool "generics"
        help
          Base set of platform abstraction wrappers, part opf cppsdk.
          Minimal set, required to use any part of this library.

if BR2_PACKAGE_CPPSDK_GENERICS

config BR2_PACKAGE_CPPSDK_WEBSOCKET
        bool "websocket"
        depends on BR2_PACKAGE_CPPSDK_GENERICS
        help
          Functionality to handle web communiciation and web socket
          communication.

config BR2_PACKAGE_CPPSDK_DEVICES
        bool "devices"
        depends on BR2_PACKAGE_CPPSDK_GENERICS
        help
          Functionality to handle hardware specific device in an
	  object oriented design.

config BR2_PACKAGE_CPPSDK_TRACING
        bool "tracing"
        depends on BR2_PACKAGE_CPPSDK_GENERICS
        help
          Functionality to handle runtime enabling and disabling of 
          tracing. This is NOT intended for LOGGING !!!

endif

endif
```

## package/dawn-browser/Config.in
```kconfig
config BR2_PACKAGE_DAWN_BROWSER
	bool "dawn-browser"
	depends on BR2_PACKAGE_QT_WEBKIT || BR2_PACKAGE_QT5WEBKIT
	help
	  Metrological's DAWN browser implementation
	  http://www.metrological.com

comment "dawn-browser needs qtwebkit or qt5webkit"
	depends on !BR2_PACKAGE_QT_WEBKIT
	depends on !BR2_PACKAGE_QT5WEBKIT
```

## package/dawn-sdk/Config.in
```kconfig
config BR2_PACKAGE_DAWN_SDK
	bool "dawn-sdk"
	depends on BR2_mipsel
	depends on BR2_INSTALL_LIBSTDCPP
	depends on BR2_LARGEFILE
	depends on BR2_TOOLCHAIN_HAS_THREADS
	select BR2_PACKAGE_HAS_OPENGL_EGL
	select BR2_PACKAGE_HAS_OPENGL_ES
	select BR2_PACKAGE_HAS_OPENVG
	help
	  DAWN SDK
	  Pre-compiled binaries of the Nexus libraries

if BR2_PACKAGE_DAWN_SDK

config BR2_PACKAGE_PROVIDES_OPENGL_EGL
	default "dawn-sdk"

config BR2_PACKAGE_PROVIDES_OPENGL_ES
	default "dawn-sdk"

config BR2_PACKAGE_PROVIDES_OPENVG
	default "dawn-sdk"

endif

comment "dawn-sdk needs a toolchain w/ C++, largefile, threads"
	depends on BR2_mipsel
	depends on !BR2_INSTALL_LIBSTDCPP || !BR2_LARGEFILE || !BR2_TOOLCHAIN_HAS_THREADS
```

## package/dejavu-fonts/Config.in
```kconfig
config BR2_PACKAGE_DEJAVU_FONTS
	bool "DejaVu fonts"
	help
	  DejaVu fonts

	  http://dejavu-fonts.org/wiki/Main_Page

if BR2_PACKAGE_DEJAVU_FONTS

config BR2_PACKAGE_DEJAVU_FONTS_MINIMIZED
	bool "minimized"
	default n

endif
```

## package/dxdrm/Config.in
```kconfig
config BR2_PACKAGE_DXDRM
	bool "dxdrm"
	depends on BR2_INSTALL_LIBSTDCPP
	depends on BR2_LARGEFILE
	depends on BR2_TOOLCHAIN_HAS_THREADS
	select BR2_PACKAGE_LIBCURL
	help
	  Discretix PlayReady DRM implementation

	  http://www.metrological.com
```

## package/flex/Config.in.host
```kconfig
config BR2_PACKAGE_HOST_FLEX
       bool "flex"
       help
         A fast lexical analyser generator.  A tool for generating
         programs that perform pattern-matching on text.

         http://flex.sourceforge.net/
```

## package/gmrender/Config.in
```kconfig
config BR2_PACKAGE_GMRENDER
	bool "gmrender"
	select BR2_PACKAGE_GST1_PLUGINS_BASE
	select BR2_PACKAGE_LIBUPNP
	help
	  Headless UPnP Renderer.

	  https://github.com/hzeller/gmrender-resurrect
```

## package/graphite2/Config.in
```kconfig
config BR2_PACKAGE_GRAPHITE2
	bool "graphite2"
	default "n"
	help
	  Graphite2 is a rework of the original Graphite engine 
```

## package/greenpeak/Config.in
```kconfig
if BR2_arm

config BR2_PACKAGE_GREENPEAK
	bool "greenpeak"
	help
	  Greenpeak kernel drivers.

if BR2_PACKAGE_GREENPEAK

config BR2_PACKAGE_GREENPEAK_GP500
  bool "GP500"
  help
    Chipset GP500

config BR2_PACKAGE_GREENPEAK_GP501
  bool "GP501"
  help
    Chipset GP501

config BR2_PACKAGE_GREENPEAK_GP510
  bool "GP510"
  help
    Chipset GP510

config BR2_PACKAGE_GREENPEAK_GP710
  bool "GP710"
  help
    Chipset GP710

config BR2_PACKAGE_GREENPEAK_GP711
  bool "GP711"
  help
    Chipset GP711

config BR2_PACKAGE_GREENPEAK_GP712
  bool "GP712"
  help
    Chipset GP712

endif

endif
```

## package/gssdp/Config.in
```kconfig
config BR2_PACKAGE_GSSDP
	bool "gssdp"
	select BR2_PACKAGE_LIBSOUP
	help
	  GSSDP implements resource discovery and announcement over SSDP.

	  http://www.gupnp.org
```

## package/gstreamer/gst-flucodecpack/Config.in
```kconfig
config BR2_PACKAGE_GST_FLUCODECPACK
	bool "gst-flucodecpack"
	depends on BR2_arm
	select BR2_PACKAGE_GST_PLUGINS_BASE
	select BR2_PACKAGE_LIBCURL
	help
	  GStreamer Fluendo Codec Pack.

	  http://www.metrological.com
```

## package/gstreamer/gst-fludash/Config.in
```kconfig
config BR2_PACKAGE_GST_FLUDASH
	bool "gst-fludash"
	depends on BR2_PACKAGE_GST_FLUCODECPACK
	select BR2_PACKAGE_LIBXML2
	help
	  GStreamer RPI DASH plug-in.

	  http://www.metrological.com
```
