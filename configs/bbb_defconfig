## configs/bbb_defconfig
```kconfig
BR2_arm=y
BR2_cortex_a8=y
BR2_ARM_EABIHF=y
BR2_KERNEL_HEADERS_VERSION=y
BR2_DEFAULT_KERNEL_VERSION="3.8.13"
BR2_TOOLCHAIN_BUILDROOT_EGLIBC=y
BR2_TOOLCHAIN_BUILDROOT_CXX=y
BR2_PACKAGE_HOST_FLEX=y
BR2_TARGET_GENERIC_HOSTNAME="beaglebone"
BR2_TARGET_GENERIC_GETTY_PORT="ttyO0"
# BR2_TARGET_GENERIC_REMOUNT_ROOTFS_RW is not set
BR2_LINUX_KERNEL=y
BR2_LINUX_KERNEL_CUSTOM_GIT=y
BR2_LINUX_KERNEL_CUSTOM_REPO_URL="git://git.ti.com/ti-linux-kernel/ti-linux-kernel.git"
BR2_LINUX_KERNEL_CUSTOM_REPO_VERSION="dbf932a9b316d5b29b3e220e5a30e7a165ad2992"
BR2_LINUX_KERNEL_USE_CUSTOM_CONFIG=y
BR2_LINUX_KERNEL_CUSTOM_CONFIG_FILE="board/beaglebone/linux-3.12.config"
BR2_LINUX_KERNEL_ZIMAGE=y
BR2_LINUX_KERNEL_DTS_SUPPORT=y
BR2_LINUX_KERNEL_INTREE_DTS_NAME="am335x-bone"
BR2_PACKAGE_QT5=y
BR2_PACKAGE_QT5BASE_LICENSE_APPROVED=y
BR2_PACKAGE_QT5BASE_EXAMPLES=y
BR2_PACKAGE_QT5BASE_CONCURRENT=y
BR2_PACKAGE_QT5BASE_LINUXFB=y
BR2_PACKAGE_QT5BASE_DIRECTFB=y
BR2_PACKAGE_QT5BASE_FONTCONFIG=y
BR2_PACKAGE_QT5BASE_GIF=y
BR2_PACKAGE_QT5BASE_JPEG=y
BR2_PACKAGE_QT5BASE_PNG=y
BR2_PACKAGE_QT5BASE_TSLIB=y
BR2_PACKAGE_QT5QUICK1=y
BR2_PACKAGE_QT5QUICKCONTROLS=y
BR2_PACKAGE_QT5WEBKIT=y
BR2_PACKAGE_MINIBROWSER=y
BR2_PACKAGE_TESTBROWSER=y
BR2_PACKAGE_AM33X_CM3=y
BR2_PACKAGE_TI_GFX=y
BR2_PACKAGE_TI_GFX_EGLIMAGE=y
BR2_PACKAGE_TI_GFX_ES8=y
BR2_PACKAGE_BLUEZ_UTILS=y
BR2_TARGET_ROOTFS_EXT2=y
# BR2_TARGET_ROOTFS_TAR is not set
BR2_TARGET_UBOOT=y
BR2_TARGET_UBOOT_BOARDNAME="am335x_evm"
BR2_TARGET_UBOOT_CUSTOM_VERSION=y
BR2_TARGET_UBOOT_CUSTOM_VERSION_VALUE="2013.10"
BR2_TARGET_UBOOT_FORMAT_IMG=y
BR2_TARGET_UBOOT_SPL=y
BR2_TARGET_UBOOT_SPL_NAME="MLO"
```

## configs/dawn-7000_wpe_nexus_proxy_defconfig
```kconfig
BR2_mipsel=y
# BR2_MIPS_SOFT_FLOAT is not set
BR2_CCACHE=y
BR2_OPTIMIZE_2=y
BR2_KERNEL_HEADERS_VERSION=y
BR2_DEFAULT_KERNEL_VERSION="3.3.8"
BR2_UCLIBC_CONFIG="board/dawn-7000/uclibc-0.9.33.config"
BR2_TOOLCHAIN_BUILDROOT_LARGEFILE=y
BR2_TOOLCHAIN_BUILDROOT_INET_IPV6=y
BR2_TOOLCHAIN_BUILDROOT_INET_RPC=y
BR2_TOOLCHAIN_BUILDROOT_WCHAR=y
BR2_TOOLCHAIN_BUILDROOT_USE_SSP=y
BR2_BINUTILS_VERSION_2_22=y
BR2_GCC_VERSION_4_8_X=y
BR2_TOOLCHAIN_BUILDROOT_CXX=y
BR2_ENABLE_LOCALE_PURGE=y
BR2_ENABLE_LOCALE_WHITELIST="C en_US"
BR2_TARGET_OPTIMIZATION="-pipe -mhard-float -march=mips32"
BR2_TARGET_GENERIC_HOSTNAME="dawn"
BR2_TARGET_SPECIFIC_INTERFACES="board/dawn-7000/interfaces.txt"
BR2_TARGET_GENERIC_ISSUE=""
BR2_ROOTFS_DEVICE_CREATION_DYNAMIC_UDEV=y
BR2_ROOTFS_DEVICE_TABLE="board/dawn-7000/device_table_dev.txt"
BR2_TARGET_GENERIC_ROOT_PASSWD="root"
BR2_TARGET_GENERIC_GETTY_TERM=""
BR2_LINUX_KERNEL=y
BR2_LINUX_KERNEL_CUSTOM_TARBALL=y
BR2_LINUX_KERNEL_CUSTOM_TARBALL_LOCATION="file://../bcm-refsw/stblinux-3.3-3.0a.tar.bz2"
BR2_LINUX_KERNEL_PATCH="board/dawn-7000/linuxgcc48.patch"
BR2_LINUX_KERNEL_USE_CUSTOM_CONFIG=y
BR2_LINUX_KERNEL_CUSTOM_CONFIG_FILE="board/dawn-7000/linux_nfs.config"
BR2_LINUX_KERNEL_VMLINUX=y
BR2_PACKAGE_XKEYBOARD_CONFIG=y
BR2_PACKAGE_BCM_REFSW=y
BR2_PACKAGE_BCM_REFSW_PLATFORM="97429"
BR2_PACKAGE_BCM_REFSW_PLATFORM_REV="B0"
BR2_BCM_REFSW_VERSION_V15=y
BR2_BCMREFSW_PROXY_MODE=y
BR2_BCMREFSW_WAYLAND_SUPPORT_NONE=y
BR2_BCM_REFSW_DEBUG_LEVEL_WARNING=y
BR2_PACKAGE_UDEV_RULES_GEN=y
BR2_PACKAGE_OPENSSL=y
BR2_PACKAGE_WAYLAND=y
BR2_PACKAGE_WPE=y
BR2_PACKAGE_LIBXKBCOMMON=y
BR2_PACKAGE_PCRE_16=y
BR2_PACKAGE_DROPBEAR=y
BR2_PACKAGE_DROPBEAR_DISABLE_REVERSEDNS=y
BR2_PACKAGE_GESFTPSERVER=y
BR2_PACKAGE_DEJAVU_FONTS=y
BR2_PACKAGE_SHARED_MIME_INFO=y
```

## configs/dawn_defconfig
```kconfig
BR2_mipsel=y
# BR2_MIPS_SOFT_FLOAT is not set

BR2_OPTIMIZE_2=y

BR2_TOOLCHAIN_BUILDROOT_LARGEFILE=y
BR2_TOOLCHAIN_BUILDROOT_INET_IPV6=y
BR2_TOOLCHAIN_BUILDROOT_INET_RPC=y
BR2_TOOLCHAIN_BUILDROOT_WCHAR=y
BR2_TOOLCHAIN_BUILDROOT_USE_SSP=y
BR2_TOOLCHAIN_BUILDROOT_CXX=y

BR2_GCC_VERSION_4_5_X=y

BR2_UCLIBC_VERSION_0_9_32=y
BR2_UCLIBC_CONFIG="board/dawn/uclibc-0.9.32.config"

BR2_ENABLE_LOCALE_PURGE=y
BR2_ENABLE_LOCALE_WHITELIST="C en_US"

BR2_TARGET_GENERIC_HOSTNAME="dawn"
BR2_TARGET_GENERIC_ISSUE=""
BR2_TARGET_GENERIC_ROOT_PASSWD="root"
BR2_TARGET_GENERIC_GETTY_PORT="ttyS0"
BR2_TARGET_GENERIC_GETTY_TERM=""

BR2_TARGET_OPTIMIZATION="-pipe -mhard-float -march=mips32"

BR2_PACKAGE_DAWN_SDK=y

BR2_PACKAGE_OPENSSL=y

BR2_PACKAGE_MLBROWSER=y

BR2_PACKAGE_QT5=y
BR2_PACKAGE_QT5BASE=y
BR2_PACKAGE_QT5DECLARATIVE=y
BR2_PACKAGE_QT5WEBKIT=y
BR2_PACKAGE_QT5BASE_LICENSE_APPROVED=y
BR2_PACKAGE_QT5BASE_SQLITE_SYSTEM=y
BR2_PACKAGE_QT5BASE_EGLFS=y
BR2_PACKAGE_QT5BASE_FONTCONFIG=y
BR2_PACKAGE_QT5BASE_GIF=y
BR2_PACKAGE_QT5BASE_JPEG=y
BR2_PACKAGE_QT5BASE_PNG=y
BR2_PACKAGE_QT5BASE_ICU=y

BR2_PACKAGE_DROPBEAR=y
BR2_PACKAGE_DROPBEAR_DISABLE_REVERSEDNS=y

BR2_PACKAGE_GESFTPSERVER=y

BR2_PACKAGE_UDEV_RULES_GEN=y

BR2_ROOTFS_DEVICE_CREATION_DYNAMIC_UDEV=y
BR2_ROOTFS_DEVICE_TABLE="board/dawn/device_table_dev.txt"
BR2_ROOTFS_POST_BUILD_SCRIPT="board/dawn/post-build.sh"

BR2_KERNEL_HEADERS_VERSION=y
BR2_DEFAULT_KERNEL_VERSION="3.3.8"

BR2_LINUX_KERNEL=y
BR2_LINUX_KERNEL_CUSTOM_TARBALL=y
BR2_LINUX_KERNEL_CUSTOM_TARBALL_LOCATION="file://../dawn/stblinux-3.3-3.0a.tar.bz2"
BR2_LINUX_KERNEL_PATCH="board/dawn/linux.patch"
BR2_LINUX_KERNEL_USE_CUSTOM_CONFIG=y
BR2_LINUX_KERNEL_CUSTOM_CONFIG_FILE="board/dawn/linux.config"
BR2_LINUX_KERNEL_VMLINUX=y
```

## configs/dawn_qtwebkit_defconfig
```kconfig
BR2_mipsel=y
# BR2_MIPS_SOFT_FLOAT is not set

BR2_OPTIMIZE_2=y

BR2_TOOLCHAIN_BUILDROOT_LARGEFILE=y
BR2_TOOLCHAIN_BUILDROOT_INET_IPV6=y
BR2_TOOLCHAIN_BUILDROOT_INET_RPC=y
BR2_TOOLCHAIN_BUILDROOT_WCHAR=y
BR2_TOOLCHAIN_BUILDROOT_USE_SSP=y
BR2_TOOLCHAIN_BUILDROOT_CXX=y

BR2_GCC_VERSION_4_5_X=y

BR2_UCLIBC_VERSION_0_9_32=y
BR2_UCLIBC_CONFIG="board/dawn/uclibc-0.9.32.config"

BR2_ENABLE_LOCALE_PURGE=y
BR2_ENABLE_LOCALE_WHITELIST="C en_US"

BR2_TARGET_GENERIC_HOSTNAME="dawn"
BR2_TARGET_GENERIC_ISSUE=""
BR2_TARGET_GENERIC_ROOT_PASSWD="root"
BR2_TARGET_GENERIC_GETTY_PORT="ttyS0"
BR2_TARGET_GENERIC_GETTY_TERM=""

BR2_TARGET_OPTIMIZATION="-pipe -mhard-float -march=mips32"

BR2_PACKAGE_DAWN_SDK=y

BR2_PACKAGE_OPENSSL=y

BR2_PACKAGE_MLBROWSER=y

BR2_PACKAGE_QT=y
BR2_PACKAGE_QT_LICENSE_APPROVED=y
BR2_PACKAGE_QT_NETWORK=y
BR2_PACKAGE_QT_GUI_MODULE=y
BR2_PACKAGE_QT_GIF=y
BR2_PACKAGE_QT_LIBMNG=y
BR2_PACKAGE_QT_QTPNG=y
BR2_PACKAGE_QT_QTJPEG=y
BR2_PACKAGE_QT_QTFREETYPE=y
BR2_PACKAGE_QT_OPENSSL=y
BR2_PACKAGE_QT_OPENGL_ES=y
BR2_PACKAGE_QT_KEYBOARD_LINUXINPUT=y
BR2_PACKAGE_QT_GFX_EGLNULLWS=y
BR2_PACKAGE_QT_WEBKIT=y

BR2_PACKAGE_DROPBEAR=y
BR2_PACKAGE_DROPBEAR_DISABLE_REVERSEDNS=y

BR2_PACKAGE_GESFTPSERVER=y

BR2_PACKAGE_UDEV_RULES_GEN=y

BR2_ROOTFS_DEVICE_CREATION_DYNAMIC_UDEV=y
BR2_ROOTFS_DEVICE_TABLE="board/dawn/device_table_dev.txt"
BR2_ROOTFS_POST_BUILD_SCRIPT="board/dawn/post-build.sh"

BR2_KERNEL_HEADERS_VERSION=y
BR2_DEFAULT_KERNEL_VERSION="3.3.8"

BR2_LINUX_KERNEL=y
BR2_LINUX_KERNEL_CUSTOM_TARBALL=y
BR2_LINUX_KERNEL_CUSTOM_TARBALL_LOCATION="file://../dawn/stblinux-3.3-3.0a.tar.bz2"
BR2_LINUX_KERNEL_PATCH="board/dawn/linux.patch"
BR2_LINUX_KERNEL_USE_CUSTOM_CONFIG=y
BR2_LINUX_KERNEL_CUSTOM_CONFIG_FILE="board/dawn/linux.config"
BR2_LINUX_KERNEL_VMLINUX=y
```

## configs/eos_dcx960_qt5webkit_nexus_15.2_proxy_hfp_defconfig
```kconfig
BR2_arm=y
BR2_cortex_a15=y
BR2_ARM_FPU_NEON_VFPV4=y
BR2_ARM_INSTRUCTIONS_THUMB2=y
BR2_CCACHE=y
BR2_OPTIMIZE_2=y
BR2_KERNEL_HEADERS_VERSION=y
BR2_DEFAULT_KERNEL_VERSION="3.14.28"
BR2_UCLIBC_CONFIG="board/dawn-7000/uclibc-0.9.33.config"
BR2_TOOLCHAIN_BUILDROOT_LARGEFILE=y
BR2_TOOLCHAIN_BUILDROOT_INET_IPV6=y
BR2_TOOLCHAIN_BUILDROOT_INET_RPC=y
BR2_TOOLCHAIN_BUILDROOT_WCHAR=y
BR2_TOOLCHAIN_BUILDROOT_USE_SSP=y
BR2_GCC_VERSION_4_8_X=y
BR2_TOOLCHAIN_BUILDROOT_CXX=y
BR2_ENABLE_LOCALE_PURGE=y
BR2_ENABLE_LOCALE_WHITELIST="C en_US"
BR2_TARGET_OPTIMIZATION="-pipe -mfpu=neon-vfpv4 -march=armv7-a -mtune=cortex-a7 -fsigned-char"
BR2_TARGET_GENERIC_HOSTNAME="eos"
BR2_TARGET_GENERIC_ISSUE="eos"
BR2_ROOTFS_DEVICE_CREATION_DYNAMIC_UDEV=y
BR2_TARGET_GENERIC_ROOT_PASSWD="root"
BR2_LINUX_KERNEL=y
BR2_LINUX_KERNEL_CUSTOM_TARBALL=y
BR2_LINUX_KERNEL_CUSTOM_TARBALL_LOCATION="file://../bcm-refsw/eos/stblinux-3.14-1.6.tar.bz2"
BR2_LINUX_KERNEL_PATCH="board/eos/dcx960.linux.patch"
BR2_LINUX_KERNEL_USE_CUSTOM_CONFIG=y
BR2_LINUX_KERNEL_CUSTOM_CONFIG_FILE="board/eos/dcx960.linux.config"
BR2_LINUX_KERNEL_ZIMAGE=y
BR2_PACKAGE_QTBROWSER=y
BR2_PACKAGE_QT5=y
BR2_PACKAGE_QT5BASE_LICENSE_APPROVED=y
BR2_PACKAGE_QT5BASE_FONTCONFIG=y
BR2_PACKAGE_QT5BASE_GIF=y
BR2_PACKAGE_QT5BASE_JPEG=y
BR2_PACKAGE_QT5BASE_PNG=y
BR2_PACKAGE_QT5BASE_HARFBUZZ=y
BR2_PACKAGE_QT5DECLARATIVE=y
BR2_PACKAGE_QT5WEBKIT=y
BR2_PACKAGE_BCM_REFSW=y
BR2_PACKAGE_BCM_REFSW_PLATFORM="97439"
BR2_PACKAGE_BCM_REFSW_PLATFORM_REV="B0"
BR2_BCM_REFSW_VERSION_V15_2=y
BR2_BCMREFSW_PROXY_MODE=y
BR2_BCMREFSW_VIDEODRIVER_VC5=y
BR2_BCM_REFSW_DEBUG_LEVEL_ERROR=y
BR2_PACKAGE_OPENSSL=y
BR2_PACKAGE_LIBJPEG=y
BR2_PACKAGE_LIBSOUP=y
BR2_PACKAGE_LIBSOUP_SSL=y
BR2_PACKAGE_CPPSDK=y
BR2_PACKAGE_CPPSDK_DEVICES=y
BR2_PACKAGE_CPPSDK_TRACING=y
BR2_PACKAGE_CPPSDK_WEBSOCKET=y
BR2_PACKAGE_DROPBEAR=y
BR2_PACKAGE_DROPBEAR_DISABLE_REVERSEDNS=y
BR2_PACKAGE_GESFTPSERVER=y
BR2_PACKAGE_KMOD=y
BR2_PACKAGE_UTIL_LINUX=y
BR2_PACKAGE_UTIL_LINUX_LIBBLKID=y
BR2_PACKAGE_WEBBRIDGE=y
BR2_PACKAGE_PLUGIN_FANCONTROL=y
BR2_PACKAGE_PLUGIN_TRACECONTROL=y
BR2_PACKAGE_PLUGIN_DELAYEDRESPONSE=y
BR2_PACKAGE_PLUGIN_WEBPROXY=y
BR2_PACKAGE_PLUGIN_I2CCONTROL=y
BR2_PACKAGE_PLUGIN_SPICONTROL=y
BR2_PACKAGE_PLUGIN_TEMPCONTROL=y
BR2_PACKAGE_PLUGIN_FILESERVER=y
BR2_PACKAGE_PLUGIN_DEVICEINFO=y
```

## configs/eos_dcx960_wpe_bcm_nexus_15.2_proxy_hfp_defconfig
```kconfig
BR2_arm=y
BR2_cortex_a15=y
BR2_ARM_EABIHF=y
BR2_ARM_FPU_NEON_VFPV4=y
BR2_OPTIMIZE_2=y
BR2_KERNEL_HEADERS_3_4=y
BR2_UCLIBC_VERSION_0_9_32=y
BR2_UCLIBC_CONFIG="board/dawn-7000/uclibc-0.9.32.config"
BR2_TOOLCHAIN_BUILDROOT_LARGEFILE=y
BR2_TOOLCHAIN_BUILDROOT_INET_IPV6=y
BR2_TOOLCHAIN_BUILDROOT_INET_RPC=y
BR2_TOOLCHAIN_BUILDROOT_WCHAR=y
BR2_TOOLCHAIN_BUILDROOT_USE_SSP=y
BR2_GCC_VERSION_4_8_X=y
BR2_TOOLCHAIN_BUILDROOT_CXX=y
BR2_ENABLE_LOCALE_PURGE=y
BR2_ENABLE_LOCALE_WHITELIST="C en_US"
BR2_TARGET_OPTIMIZATION="-pipe -mfpu=neon-vfpv4 -march=armv7-a -mtune=cortex-a7"
BR2_TARGET_GENERIC_HOSTNAME="eos"
BR2_TARGET_GENERIC_ISSUE="eos"
BR2_TARGET_GENERIC_ROOT_PASSWD="root"
BR2_LINUX_KERNEL=y
BR2_LINUX_KERNEL_CUSTOM_TARBALL=y
BR2_LINUX_KERNEL_CUSTOM_TARBALL_LOCATION="file://../bcm-refsw/eos/stblinux-3.14-1.6.tar.bz2"
BR2_LINUX_KERNEL_PATCH="board/eos/dcx960.linux.patch"
BR2_LINUX_KERNEL_USE_CUSTOM_CONFIG=y
BR2_LINUX_KERNEL_CUSTOM_CONFIG_FILE="board/eos/dcx960.linux.config"
BR2_LINUX_KERNEL_ZIMAGE=y
BR2_PACKAGE_GSTREAMER1=y
BR2_PACKAGE_GSTREAMER1_GIT=y
BR2_PACKAGE_GST1_PLUGINS_GOOD_PLUGIN_SOUPHTTPSRC=y
BR2_PACKAGE_GST1_PLUGINS_BCM=y
BR2_PACKAGE_GST1_PLUGINS_BCM_PLUGIN_AUDFILTER=y
BR2_PACKAGE_GST1_PLUGINS_BCM_PLUGIN_AUDIODECODE=y
BR2_PACKAGE_GST1_PLUGINS_BCM_PLUGIN_AUDIOSINK=y
BR2_PACKAGE_GST1_PLUGINS_BCM_PLUGIN_GFXSINK=y
BR2_PACKAGE_GST1_PLUGINS_BCM_PLUGIN_MP3SWDECODE=y
BR2_PACKAGE_GST1_PLUGINS_BCM_PLUGIN_PCMSINK=y
BR2_PACKAGE_GST1_PLUGINS_BCM_PLUGIN_PLAYERSINKBIN=y
BR2_PACKAGE_GST1_PLUGINS_BCM_PLUGIN_VIDEODECODE=y
BR2_PACKAGE_GST1_PLUGINS_BCM_PLUGIN_VIDEOSINK=y
BR2_PACKAGE_GST1_PLUGINS_BCM_PLUGIN_VIDFILTER=y
BR2_PACKAGE_DXDRM=y
BR2_PACKAGE_BCM_REFSW=y
BR2_PACKAGE_BCM_REFSW_PLATFORM="97439"
BR2_PACKAGE_BCM_REFSW_PLATFORM_REV="B0"
BR2_BCM_REFSW_VERSION_V15_2=y
BR2_BCMREFSW_PROXY_MODE=y
BR2_BCMREFSW_VIDEODRIVER_VC5=y
BR2_BCM_REFSW_DEBUG_LEVEL_ERROR=y
BR2_BCM_REFSW_INSTALL_NXSERVER=y
BR2_PACKAGE_LIBJPEG=y
BR2_PACKAGE_WPE=y
BR2_PACKAGE_WPE_USE_ENCRYPTED_MEDIA=y
BR2_PACKAGE_WPE_USE_DXDRM_EME=y
BR2_PACKAGE_WPE_USE_MEDIA_SOURCE=y
BR2_PACKAGE_WPE_USE_HOLE_PUNCH_GSTREAMER=y
BR2_PACKAGE_CPPSDK_DEVICES=y
BR2_PACKAGE_CPPSDK_TRACING=y
BR2_PACKAGE_CPPSDK_WEBSOCKET=y
BR2_PACKAGE_PCRE_16=y
BR2_PACKAGE_DROPBEAR=y
BR2_PACKAGE_DROPBEAR_DISABLE_REVERSEDNS=y
BR2_PACKAGE_GESFTPSERVER=y
BR2_PACKAGE_KMOD=y
BR2_PACKAGE_UTIL_LINUX=y
BR2_PACKAGE_UTIL_LINUX_LIBBLKID=y
BR2_PACKAGE_WEBBRIDGE=y
BR2_PACKAGE_PLUGIN_FANCONTROL=y
BR2_PACKAGE_PLUGIN_TRACECONTROL=y
BR2_PACKAGE_PLUGIN_DELAYEDRESPONSE=y
BR2_PACKAGE_PLUGIN_PROVISIONING=y
BR2_PACKAGE_PLUGIN_WEBPROXY=y
BR2_PACKAGE_PLUGIN_I2CCONTROL=y
BR2_PACKAGE_PLUGIN_SPICONTROL=y
BR2_PACKAGE_PLUGIN_TEMPCONTROL=y
BR2_PACKAGE_PLUGIN_FILESERVER=y
BR2_PACKAGE_PLUGIN_DEVICEINFO=y
```

## configs/eos_qt5webkit_ml_defconfig
```kconfig
BR2_arm=y
BR2_cortex_a15=y
BR2_ARM_EABI=y
BR2_ARM_FPU_NEON_VFPV4=y
BR2_CCACHE=y
BR2_OPTIMIZE_2=y
BR2_PACKAGE_HOST_LINUX_HEADERS_CUSTOM_3_14=y
BR2_TOOLCHAIN_BUILDROOT_GLIBC=y
BR2_TOOLCHAIN_BUILDROOT_CXX=y
BR2_GCC_VERSION_4_9_X=y
BR2_ENABLE_LOCALE_PURGE=y
BR2_ENABLE_LOCALE_WHITELIST="C en_US"
BR2_TARGET_GENERIC_CABUNDLE=y
BR2_ROOTFS_DEVICE_CREATION_DYNAMIC_EUDEV=y
BR2_TARGET_GENERIC_ROOT_PASSWD="root"
BR2_TARGET_GENERIC_GETTY_PORT="tty1"
BR2_SYSTEM_DHCP="eth0"

BR2_LINUX_KERNEL=y
BR2_LINUX_KERNEL_CUSTOM_GIT=y
BR2_LINUX_KERNEL_CUSTOM_REPO_URL="git@github.com:Metrological/bcm-stblinux-3.14.git"
BR2_LINUX_KERNEL_CUSTOM_REPO_VERSION="3.14-1.6"
BR2_LINUX_KERNEL_PATCH="board/eos/linux.patch"
BR2_LINUX_KERNEL_USE_CUSTOM_CONFIG=y
BR2_LINUX_KERNEL_CUSTOM_CONFIG_FILE="board/eos/linux.config"
BR2_LINUX_KERNEL_ZIMAGE=y

BR2_PACKAGE_BUSYBOX_SMP=y
BR2_PACKAGE_OPENSSL=y
BR2_PACKAGE_LIBJPEG=y
BR2_PACKAGE_LIBSOUP=y
BR2_PACKAGE_LIBSOUP_SSL=y

BR2_PACKAGE_SHARED_MIME_INFO=y
BR2_PACKAGE_DROPBEAR=y
BR2_PACKAGE_GESFTPSERVER=y
BR2_PACKAGE_BCM_REFSW=y
BR2_BCMREFSW_PROXY_MODE=y

BR2_PACKAGE_QTBROWSER=y
BR2_PACKAGE_QT5=y
BR2_PACKAGE_QT5BASE_LICENSE_APPROVED=y
BR2_PACKAGE_QT5BASE_SQLITE_SYSTEM=y
BR2_PACKAGE_QT5BASE_EGLFS=y
BR2_PACKAGE_QT5BASE_FONTCONFIG=y
BR2_PACKAGE_QT5BASE_GIF=y
BR2_PACKAGE_QT5BASE_JPEG=y
BR2_PACKAGE_QT5BASE_PNG=y
BR2_PACKAGE_QT5WEBKIT=y

BR2_PACKAGE_CPPSDK=y
BR2_PACKAGE_CPPSDK_DEVICES=y
BR2_PACKAGE_WEBBRIDGE=y
BR2_PACKAGE_PLUGIN_TRACECONTROL=y
BR2_PACKAGE_PLUGIN_MONITOR=y
BR2_PACKAGE_PLUGIN_PROVISIONING=y
BR2_PACKAGE_PLUGIN_REMOTECONTROL=y
BR2_PACKAGE_PLUGIN_DEVICEINFO=y
```

## configs/eos_qt5webkit_nexus_proxy_defconfig
```kconfig
BR2_arm=y
BR2_cortex_a15=y
BR2_ARM_SOFT_FLOAT=y
BR2_OPTIMIZE_2=y
BR2_KERNEL_HEADERS_3_4=y
BR2_UCLIBC_VERSION_0_9_32=y
BR2_UCLIBC_CONFIG="board/dawn/uclibc-0.9.32.config"
BR2_TOOLCHAIN_BUILDROOT_LARGEFILE=y
BR2_TOOLCHAIN_BUILDROOT_INET_IPV6=y
BR2_TOOLCHAIN_BUILDROOT_INET_RPC=y
BR2_TOOLCHAIN_BUILDROOT_WCHAR=y
BR2_TOOLCHAIN_BUILDROOT_USE_SSP=y
BR2_GCC_VERSION_4_8_X=y
BR2_TOOLCHAIN_BUILDROOT_CXX=y
BR2_ENABLE_LOCALE_PURGE=y
BR2_ENABLE_LOCALE_WHITELIST="C en_US"
BR2_TARGET_OPTIMIZATION="-pipe"
BR2_TARGET_GENERIC_HOSTNAME="eos"
BR2_TARGET_GENERIC_ISSUE="eos"
BR2_TARGET_GENERIC_ROOT_PASSWD="root"
BR2_LINUX_KERNEL=y
BR2_LINUX_KERNEL_CUSTOM_TARBALL=y
BR2_LINUX_KERNEL_CUSTOM_TARBALL_LOCATION="file://../bcm-refsw/stblinux-3.3-3.0a.tar.bz2"
BR2_LINUX_KERNEL_PATCH="board/dawn/linux.patch"
BR2_LINUX_KERNEL_USE_CUSTOM_CONFIG=y
BR2_LINUX_KERNEL_CUSTOM_CONFIG_FILE="board/dawn/linux_nfs.config"
BR2_LINUX_KERNEL_VMLINUX=y
BR2_PACKAGE_QTBROWSER=y
BR2_PACKAGE_QT5=y
BR2_PACKAGE_QT5BASE_LICENSE_APPROVED=y
BR2_PACKAGE_QT5BASE_SQLITE_SYSTEM=y
BR2_PACKAGE_QT5BASE_EGLFS=y
BR2_PACKAGE_QT5BASE_FONTCONFIG=y
BR2_PACKAGE_QT5BASE_GIF=y
BR2_PACKAGE_QT5BASE_JPEG=y
BR2_PACKAGE_QT5BASE_PNG=y
BR2_PACKAGE_QT5WEBKIT=y
BR2_PACKAGE_BCM_REFSW=y
BR2_PACKAGE_BCM_REFSW_PLATFORM="97449"
BR2_PACKAGE_BCM_REFSW_PLATFORM_REV="D0"
BR2_BCMREFSW_PROXY_MODE=y
BR2_BCM_REFSW_DEBUG_LEVEL_ERROR=y
BR2_BCM_REFSW_VERSION_V14=y
BR2_PACKAGE_OPENSSL=y
BR2_PACKAGE_LIBJPEG=y
BR2_PACKAGE_LIBSOUP=y
BR2_PACKAGE_LIBSOUP_SSL=y
BR2_PACKAGE_ICU_MINIMIZED=y
BR2_PACKAGE_DROPBEAR=y
BR2_PACKAGE_DROPBEAR_DISABLE_REVERSEDNS=y
BR2_PACKAGE_GESFTPSERVER=y
BR2_PACKAGE_KMOD=y
BR2_PACKAGE_UTIL_LINUX=y
BR2_PACKAGE_UTIL_LINUX_LIBBLKID=y
```
