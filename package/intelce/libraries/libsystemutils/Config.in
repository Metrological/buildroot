## package/intelce/libraries/libsystemutils/Config.in
```kconfig
config BR2_PACKAGE_LIBSYSTEM_UTILS
	bool "libsystem-utils"
	depends on BR2_TOOLCHAIN_HAS_THREADS
	select BR2_PACKAGE_LIBPLATFORMCONFIG
	help
		Intel CE System Utils library

comment "libsystem-utils requires a toolchain with thread support"
	depends on !BR2_TOOLCHAIN_HAS_THREADS
```

## package/intelce/multimedia/khronos/Config.in
```kconfig
config BR2_PACKAGE_KHRONOS
	bool "khronos"
	depends on BR2_PACKAGE_LIBGDL
	depends on BR2_PACKAGE_LIBGMA
	select BR2_PACKAGE_HAS_OPENGL_EGL
	select BR2_PACKAGE_HAS_OPENGL_ES
	select BR2_PACKAGE_HAS_OPENVG
	help
		Intel CE Khronos Graphical libraries
	
comment "Khronos requires libgdl and libgma"
	depends on !BR2_PACKAGE_LIBGDL || !BR2_PACKAGE_LIBGMA
 
if BR2_PACKAGE_KHRONOS

config BR2_PACKAGE_PROVIDES_OPENGL_EGL
	default "khronos"

config BR2_PACKAGE_PROVIDES_OPENGL_ES
	default "khronos"

config BR2_PACKAGE_PROVIDES_OPENVG
	default "khronos"

endif
```

## package/isl/Config.in
```kconfig
config BR2_PACKAGE_ISL
	bool "isl"
	select BR2_PACKAGE_GMP
	help
	  isl is a library for manipulating sets and relations of
	  integer points bounded by linear constraints. 

	  http://freecode.com/projects/isl
```

## package/libav/Config.in
```kconfig
config BR2_PACKAGE_LIBAV
	bool "libav"
	depends on BR2_PACKAGE_ZLIB
	depends on BR2_TOOLCHAIN_BUILDROOT_INET_IPV6
	default n
	help
		Libav provides cross-platform tools and libraries to 
		convert, manipulate and stream a wide range of 
		multimedia formats and protocols		
```

## package/libcec-uinput/Config.in
```kconfig
config BR2_PACKAGE_LIBCEC_UINPUT
	select BR2_PACKAGE_LIBCEC
	select BR2_PACKAGE_LIBCEC_RPI if BR2_PACKAGE_RPI_USERLAND
	select BR2_PACKAGE_BOOST
	select BR2_PACKAGE_BOOST_PROGRAM_OPTIONS
	select BR2_PACKAGE_LOG4CPLUS
	bool "libcec-uinput"
	help
	  libcec uinput deamon.
```

## package/libgtk3/Config.in
```kconfig
config BR2_PACKAGE_LIBGTK3
	bool "libgtk3"
	select BR2_PACKAGE_ATK
	select BR2_PACKAGE_CAIRO
	select BR2_PACKAGE_CAIRO_PS
	select BR2_PACKAGE_CAIRO_PDF
	select BR2_PACKAGE_CAIRO_SVG
	select BR2_PACKAGE_LIBGLIB2
	select BR2_PACKAGE_PANGO
	select BR2_PACKAGE_GDK_PIXBUF
	select BR2_PACKAGE_FONTCONFIG if BR2_PACKAGE_XORG7
	select BR2_PACKAGE_XLIB_LIBX11 if BR2_PACKAGE_XORG7
	select BR2_PACKAGE_XLIB_LIBXEXT if BR2_PACKAGE_XORG7
	select BR2_PACKAGE_XLIB_LIBXRENDER if BR2_PACKAGE_XORG7
	select BR2_PACKAGE_DEJAVU_FONTS
	depends on BR2_PACKAGE_XORG7 || BR2_PACKAGE_WAYLAND
	depends on BR2_USE_MMU # glib2
	depends on BR2_USE_WCHAR # glib2
	depends on BR2_INSTALL_LIBSTDCPP # pango
	help
	  The GTK+ version 3 graphical user interface library

	  http://www.gtk.org/

comment "libgtk3 needs a toolchain w/ wchar, threads, C++"
	depends on BR2_USE_MMU
	depends on !BR2_USE_WCHAR || !BR2_INSTALL_LIBSTDCPP || \
		!BR2_TOOLCHAIN_HAS_THREADS
```

## package/libmng/Config.in
```kconfig
config BR2_PACKAGE_LIBMNG
	bool "libmng"
	select BR2_PACKAGE_ZLIB
	help
		Library for handling MNG (Multiple-image Network Graphics)
		images.
		http://www.libmng.com/
```

## package/libnice/Config.in
```kconfig
config BR2_PACKAGE_LIBNICE
	bool "libnice"
	help
	  Libnice is an implementation of the IETF's Interactive Connectivity
	  Establishment (ICE) standard (RFC 5245) and the Session Traversal
	  Utilities for NAT (STUN) standard (RFC 5389).

	  It provides a GLib-based library, libnice and a Glib-free library,
	  libstun as well as GStreamer elements.

	  ICE is useful for applications that want to establish peer-to-peer UDP
	  data streams. It automates the process of traversing NATs and provides
	  security against some attacks. It also allows applications to create
	  reliable streams using a TCP over UDP layer.

	  Existing standards that use ICE include Session Initiation Protocol
	  (SIP) and XMPP Jingle.

	  http://nice.freedesktop.org/wiki/
```

## package/libsrtp/Config.in
```kconfig
config BR2_PACKAGE_LIBSRTP
	bool "libsrtp"
	help
	  The libSRTP library is an open-source implementation of the
	  Secure Real-time Transport Protocol (SRTP) originally
	  authored by Cisco Systems, Inc. It is available under a
	  BSD-style license.

	  http://srtp.sourceforge.net/
```

## package/libxkbcommon/Config.in
```kconfig
config BR2_PACKAGE_LIBXKBCOMMON
	bool "libxkbcommon"
	help
	  xkbcommon is a keymap compiler and support library which
	  processes a reduced subset of keymaps as defined by the XKB
	  specification.

	  http://xkbcommon.org/

config BR2_PACKAGE_LIBXKBCOMMON_X11
	bool "libxkbcommon-x11"
	depends on BR2_PACKAGE_LIBXKBCOMMON
	help
	  Support creating keymaps with the X11 protocol

comment "libxkbcommon-x11 depends on libxkbcommon"
	depends on !BR2_PACKAGE_LIBXKBCOMMON
```

## package/mlbrowser/Config.in
```kconfig
config BR2_PACKAGE_MLBROWSER
	bool "mlbrowser"
	depends on BR2_PACKAGE_QT_WEBKIT || BR2_PACKAGE_QT5WEBKIT
	help
	  Metrological's simple (accelerated) browser implementation
	  http://www.metrological.com

comment "mlbrowser needs qtwebkit or qt5webkit"
	depends on !BR2_PACKAGE_QT_WEBKIT
	depends on !BR2_PACKAGE_QT5WEBKIT
```

## package/nrd/Config.in
```kconfig
config BR2_PACKAGE_NRD
	bool "nrd"
	depends on BR2_INET_IPV6
	select BR2_PACKAGE_LIBMNG
	select BR2_PACKAGE_LIBPNG
	select BR2_PACKAGE_ICU
	select BR2_PACKAGE_JPEG
	select BR2_PACKAGE_WEBP
	select BR2_PACKAGE_FREETYPE
	select BR2_PACKAGE_EXPAT
	select BR2_PACKAGE_OPENSSL
	select BR2_PACKAGE_C_ARES
	select BR2_PACKAGE_LIBCURL
	select BR2_PACKAGE_HARFBUZZ
	help
	  A Resource Development Kit for playing content from a thirdparty

if BR2_PACKAGE_NRD

choice 
	prompt "The NRD main is build as:"

config BR2_PACKAGE_NRD_APPLICATION_EXECUTABLE
	bool "executable"
	help
	  Build the nrd main as a stand-alone application.

if BR2_PACKAGE_NRD_APPLICATION_EXECUTABLE

	config BR2_PACKAGE_NRD_BROWSER_PLUGIN_MODE
	bool "browser plugin mode"
	help
	  Build support to start nrd by the NRDPLUGIN

choice
	prompt "JSC links to the NRD main as:"

config BR2_PACKAGE_NRD_JSC_DYNAMIC
	bool "dynamic library"
	help
	  Build the JSC core as a dynamic library.
comment "This might produce libraries that conflict with other WebKit (JSC) libraries"
depends on BR2_PACKAGE_NRD_JSC_DYNAMIC

config BR2_PACKAGE_NRD_JSC_STATIC
	bool "static library"
	help
	  Build the JSC core as a static library.
endchoice

config BR2_PACKAGE_NRD_JSC_LIBRARY_TYPE
	string
	default 0 if !BR2_PACKAGE_NRD_JSC_STATIC && !BR2_PACKAGE_NRD_JSC_DYNAMIC
	default 0 if BR2_PACKAGE_NRD_JSC_STATIC
	default 1 if BR2_PACKAGE_NRD_JSC_DYNAMIC
endif

config BR2_PACKAGE_NRD_APPLICATION_SHARED
	bool "shared library"

comment "This might produce libraries that conflict with other WebKit (JSC) libraries"
depends on BR2_PACKAGE_NRD_APPLICATION_SHARED

config BR2_PACKAGE_NRD_APPLICATION_STATIC
	bool "static library"

endchoice

config BR2_PACKAGE_NRD_MODE
	string
	default "executable" if BR2_PACKAGE_NRD_APPLICATION_EXECUTABLE
	default "shared" if BR2_PACKAGE_NRD_APPLICATION_SHARED
	default "static" if BR2_PACKAGE_NRD_APPLICATION_STATIC


choice
	prompt "What graphics access system layer to be used"

config BR2_PACKAGE_NRD_GRAPHICS_DIRECTFB
	bool "directfb"
	select BR2_PACKAGE_ALSA_LIB
	select BR2_PACKAGE_TREMOR
	select BR2_PACKAGE_FFMPEG
	select BR2_PACKAGE_PORTAUDIO
	depends on BR2_PACKAGE_DIRECTFB
	help
	  Use the DirectFB access layer.

config BR2_PACKAGE_NRD_GRAPHICS_GLES2_EGL
	bool "gles2-egl"
	depends on BR2_PACKAGE_HAS_OPENGL_EGL
	help
	  Use the GLESV2-EGL access layer.
 
config BR2_PACKAGE_NRD_GRAPHICS_GLES2
	bool "gles2"
	depends on BR2_PACKAGE_HAS_OPENGL_ES
	help
	  Use the GLESV2 access layer.

config BR2_PACKAGE_NRD_GRAPHICS_METROLOGICAL
	bool "metrological"
	depends on BR2_PACKAGE_HAS_OPENGL_ES
	help
	  Use the EGL access layer based on a plugin structure.


config BR2_PACKAGE_NRD_GRAPHICS_NULL
	bool "null"
	help
	  Use the NULL access layer.
 
endchoice

config BR2_PACKAGE_NRD_GRAPHICS
	string
	default "directfb" if BR2_PACKAGE_NRD_GRAPHICS_DIRECTFB
	default "gles2" if BR2_PACKAGE_NRD_GRAPHICS_GLES2
	default "gles2-egl" if BR2_PACKAGE_NRD_GRAPHICS_GLES2_EGL
	default "metrological-egl" if BR2_PACKAGE_NRD_GRAPHICS_METROLOGICAL
	default "null" if BR2_PACKAGE_NRD_GRAPHICS_NULL


choice
	prompt "Which media playback implementation should we use:"

config BR2_PACKAGE_NRD_PLAYER_SKELETON
	bool "skeleton"
	help
	  Build NRD using a stubbed media playback skeleton from NRD.

config BR2_PACKAGE_NRD_PLAYER_X86
	bool "reference"
	depends on BR2_i386
	help
	  Build NRD using the x86 media playback implementation

config BR2_PACKAGE_NRD_PLAYER_METROLOGICAL
	bool "metrological"
	depends on BR2_i386 || BR2_arm || BR2_mips
	help
	  Build NRD using the Metrological media playback implementation

config BR2_PACKAGE_NRD_PLAYER_RASPBERRY
	bool "raspberrypi"
	help
	  Build NRD with raspberry support

config BR2_PACKAGE_NRD_PLAYER_INTELCE
	bool "intelce"
	help
	  Build NRD with Intel CE 3100 support

endchoice

config BR2_PACKAGE_NRD_PLAYER
	string
	default "skeleton" if BR2_PACKAGE_NRD_PLAYER_SKELETON
	default "reference" if BR2_PACKAGE_NRD_PLAYER_X86
	default "metrological" if BR2_PACKAGE_NRD_PLAYER_METROLOGICAL
	default "raspberrypi" if BR2_PACKAGE_NRD_PLAYER_RASPBERRY
	default "intelce" if BR2_PACKAGE_NRD_PLAYER_INTELCE

choice
	prompt "Which input method should we use:"

config BR2_PACKAGE_NRD_INPUT_DEVINPUT
	bool "devinput"
	help
	  Build NRD using the device devinput

config BR2_PACKAGE_NRD_INPUT_METROLOGICAL
	bool "metrological"
	help
	  Build NRD using the interface MetrologicalInput to insert keys via this method.

config BR2_PACKAGE_NRD_INPUT_AUTO
	bool "auto"
	help
	  Build NRD using the 'auto' input device. The input method is defined in the platform definitions.

endchoice

config BR2_PACKAGE_NRD_INPUT
	string
	default "devinput" if BR2_PACKAGE_NRD_INPUT_DEVINPUT
	default "metrological" if BR2_PACKAGE_NRD_INPUT_METROLOGICAL
	default "null" if !BR2_PACKAGE_NRD_INPUT_DEVINPUT || !BR2_PACKAGE_NRD_INPUT_METROLOGICAL

config BR2_PACKAGE_NRD_DRM_ENABLED
	bool "DRM"

if BR2_PACKAGE_NRD_DRM_ENABLED
choice
	prompt "Which type of playready library:"
config BR2_PACKAGE_NRD_DRM_INTERNAL
	bool "internal drm"
	help
	  Build NRD with one of the built-in PLAYREADY libraries

config BR2_PACKAGE_NRD_DRM_EXTERNAL
	bool "external drm"
	help
	  Build NRD with an external DRM library
endchoice
endif

if BR2_PACKAGE_NRD_DRM_INTERNAL
choice 
	prompt "Which playready version should we use:"

config BR2_PACKAGE_NRD_PLAYREADY
	bool "playready 1.2"
	help
	  Build NRD using the PlayReady version 1.2.

config BR2_PACKAGE_NRD_PLAYREADY2
	bool "playready 2 ss"
	help
	  Build NRD using the PlayReady version 2 (ss).

config BR2_PACKAGE_NRD_PLAYREADY25
	bool "playready 2.5 tee"
	help
	  Build NRD using the PlayReady version 2.5 (tee).
endchoice
endif

if BR2_PACKAGE_NRD_DRM_EXTERNAL
config BR2_PACKAGE_NRD_PLAYREADY_DXDRM
	bool "playready dxdrm"
	help
	  Build NRD using the PlayReady DxDrm.
comment "external playready support depends on dxdrm"
	depends on !BR2_PACKAGE_DXDRM
endif

#   'playready1.2', 'playready2.0-ss', 'playready2.5tee', 'playready2.5-ss-tee
config BR2_PACKAGE_NRD_DRM
	string
	default "playready1.2" if BR2_PACKAGE_NRD_PLAYREADY
	default "playready2.0-ss" if BR2_PACKAGE_NRD_PLAYREADY2
	default "playready2.5tee" if BR2_PACKAGE_NRD_PLAYREADY25
#	default "playready2.5-ss-tee" if BR2_PACKAGE_NRD_PLAYREADY25
	default "playready-dxdrm" if BR2_PACKAGE_NRD_PLAYREADY_DXDRM
	default "none" if !BR2_PACKAGE_NRD_PLAYREADY && !BR2_PACKAGE_NRD_PLAYREADY2 && !BR2_PACKAGE_NRD_PLAYREADY25 && !BR2_PACKAGE_NRD_PLAYREADY_DXDRM


config BR2_PACKAGE_NRD_NICE_THREADS
	bool "nice threads"
	help
	  Build the nrd framework using nice threading model.

config BR2_PACKAGE_NRD_DOLYDIGITALPLUS_STUBBED
	bool "DDPlus stub"
	default y
	select BR2_PACKAGE_DDPSTUB
	help
	  There is no actual implementation for the DolbyDigital Plus 
	  audio component. Please use the stub.

endif
```

## package/nrdplugin/Config.in
```kconfig
config BR2_PACKAGE_NRDPLUGIN
	bool "nrd plugin"
	depends on BR2_PACKAGE_NRD
	select BR2_PACKAGE_CPPSDK
	select BR2_PACKAGE_CPPSDK_GENERICS
	help
	  plugin package for the nrd framework

if BR2_PACKAGE_NRDPLUGIN

config BR2_PACKAGE_NRDPLUGIN_QT
	depends on BR2_PACKAGE_QT5WEBKIT
	bool "nrd qt plugin"
	help
	  QT based plugin of the nrd framework. To be used, for example in WebKit environment
comment "nrd plugin requires nrdwrapper"
depends on !BR2_PACKAGE_NRDWRAPPER

endif
```

## package/qt5/qt5webengine/Config.in
```kconfig
config BR2_PACKAGE_QT5WEBENGINE
	bool "qt5webengine"
	select BR2_PACKAGE_QT5BASE
	select BR2_PACKAGE_QT5BASE_ICU
	select BR2_PACKAGE_QT5BASE_NETWORK
	select BR2_PACKAGE_QT5BASE_SQL
	select BR2_PACKAGE_QT5BASE_XML
	select BR2_PACKAGE_QT5BASE_GUI
	select BR2_PACKAGE_QT5BASE_WIDGETS
	select BR2_PACKAGE_QT5BASE_PRINTSUPPORT
	select BR2_PACKAGE_QT5DECLARATIVE
	select BR2_PACKAGE_LIBCAP
	select BR2_PACKAGE_SQLITE
	select BR2_PACKAGE_DBUS
	select BR2_PACKAGE_XLIB_LIBXEXT if BR2_PACKAGE_QT5BASE_XCB
	select BR2_PACKAGE_XLIB_LIBXRENDER if BR2_PACKAGE_QT5BASE_XCB
	# This module does not support static linking
	depends on !BR2_PREFER_STATIC_LIB
	depends on BR2_PACKAGE_QT5_JSCORE_AVAILABLE
	help
	  http://qt-project.org
```
