## package/qt5/qt5webkit/Config.in
```kconfig
config BR2_PACKAGE_QT5WEBKIT
	bool "qt5webkit"
	select BR2_PACKAGE_QT5BASE
	select BR2_PACKAGE_QT5BASE_ICU
	select BR2_PACKAGE_QT5BASE_NETWORK
	select BR2_PACKAGE_QT5BASE_SQL
	select BR2_PACKAGE_QT5BASE_XML
	select BR2_PACKAGE_QT5BASE_GUI
	select BR2_PACKAGE_QT5BASE_WIDGETS
	select BR2_PACKAGE_QT5BASE_PRINTSUPPORT
	select BR2_PACKAGE_SQLITE
	select BR2_PACKAGE_XLIB_LIBXEXT if BR2_PACKAGE_QT5BASE_XCB
	select BR2_PACKAGE_XLIB_LIBXRENDER if BR2_PACKAGE_QT5BASE_XCB
	# This module does not support static linking
	depends on !BR2_PREFER_STATIC_LIB
	depends on BR2_PACKAGE_QT5_JSCORE_AVAILABLE
	help
	  Qt is a cross-platform application and UI framework for
	  developers using C++.

	  This package corresponds to the qt5webkit module.

	  http://qt-project.org

menu "Extra options"

config BR2_QT5WEBKIT_USE_DISCOVERY
	bool "discovery"
	default n
	select BR2_PACKAGE_DBUS
	select BR2_PACKAGE_AVAHI
	select BR2_PACKAGE_AVAHI_DAEMON
	select BR2_PACKAGE_GUPNP
	help
	  Network Service Discovery API

config BR2_QT5WEBKIT_USE_LOCATION
	bool "location"
	default y
	select BR2_PACKAGE_QT5LOCATION
	help
	  Location API

config BR2_QT5WEBKIT_USE_ORIENTATION
	bool "orientation"
	default y
	select BR2_PACKAGE_QT5SENSORS
	help
	  Device Orientation API

config BR2_QT5WEBKIT_USE_ACCELERATED_CANVAS
	bool "accelerated-canvas"
	default y
	depends on BR2_PACKAGE_HAS_OPENGL_ES
	help
	  Hardware accelerated canvas

comment "Accelerated canvas depends on OpenGL (ES)"
	depends on !BR2_PACKAGE_HAS_OPENGL_ES

config BR2_QT5WEBKIT_USE_GSTREAMER
	bool "gstreamer"
	depends on BR2_PACKAGE_GSTREAMER1
	default y
	select BR2_PACKAGE_GST1_PLUGINS_BASE
	select BR2_PACKAGE_GST1_PLUGINS_BASE_PLUGIN_GIO
	select BR2_PACKAGE_GST1_PLUGINS_GOOD
	select BR2_PACKAGE_GST1_PLUGINS_GOOD_PLUGIN_AUTODETECT
	select BR2_PACKAGE_GST1_PLUGINS_GOOD_PLUGIN_INTERLEAVE
	select BR2_PACKAGE_GST1_PLUGINS_GOOD_PLUGIN_WAVENC
	select BR2_PACKAGE_GST1_PLUGINS_GOOD_PLUGIN_WAVPARSE
	help
	  Use GStreamer 1.x for media playback support. Recommended option.

config BR2_QT5WEBKIT_USE_ENCRYPTED_MEDIA
	bool "encrypted-media"
	depends on BR2_QT5WEBKIT_USE_GSTREAMER
	select BR2_PACKAGE_OPENSSL
	default y
	help
	  Enable Encrypted Media Extensions.

config BR2_QT5WEBKIT_USE_DXDRM_EME
	bool "dxdrm-eme"
	default y if BR2_PACKAGE_DXDRM
	select BR2_QT5WEBKIT_USE_ENCRYPTED_MEDIA
	depends on BR2_PACKAGE_DXDRM
	help
	  Enable Discretix DRM Encrypted Media Extensions backend.

config BR2_QT5WEBKIT_USE_WEBRTC
	bool "WebRTC"
	default n
	select BR2_PACKAGE_LIBNICE
	depends on BR2_QT5WEBKIT_USE_GSTREAMER
	help
	  WebRTC mediastream/getUserMedia API

config BR2_QT5WEBKIT_ENABLE_JS_MEMORY_TRACKING
	bool "JavaScript memory tracking"
	default n
	help
	  Whether to compile the javascript memory tracking option (which
	  then needs to be activated with the JSC_showAllocationBacktraces
	  environment variable).

config BR2_QT5WEBKIT_ENABLE_DUMP_NODE_STATISTICS
	bool "DOM Nodes allocation tracking"
	default n
	help
	  Whether keep track of the allocated DOM Nodes or not. If this is
	  enabled then at runtime one can set the WEBKIT_DUMP_NODE_STATISTICS
	  env var to an integer. Setting the variable to 5 for instance, the
	  browser will dump node statistics on stdout every 5 seconds.

config BR2_PACKAGE_MINIBROWSER
	bool "minibrowser"
	depends on BR2_PACKAGE_QT5DECLARATIVE

config BR2_PACKAGE_TESTBROWSER
	bool "testbrowser"

config BR2_PACKAGE_DUMPRENDERTREE
	bool "dumprendertree"

config BR2_QT5WEBKIT_USE_WEBINSPECTOR
	bool "webinspector"
	default y
	help
	  Enable web inspector in build

config BR2_QT5WEBKIT_USE_SVG
	bool "SVG support"
	default y
	help
	  Enable SVG support in browser

endmenu
```

## package/qt5/qtwebdriver/Config.in
```kconfig
config BR2_PACKAGE_QTWEBDRIVER
	bool "qtwebdriver"
	depends on BR2_PACKAGE_QT_WEBKIT || BR2_PACKAGE_QT5WEBKIT
	help
	  Cisco's qtwebdriver implementation, see
	  https://github.com/cisco-open-source/qtwebdriver

comment "qtwebdriver needs qtwebkit or qt5webkit"
	depends on !BR2_PACKAGE_QT_WEBKIT
	depends on !BR2_PACKAGE_QT5WEBKIT
```

## package/qtbrowser/Config.in
```kconfig
config BR2_PACKAGE_QTBROWSER
	bool "qtbrowser"
	depends on BR2_PACKAGE_QT_WEBKIT || BR2_PACKAGE_QT5WEBKIT || BR2_PACKAGE_NRDPLUGIN
	help
	  Metrological's qtbrowser implementation
	  http://www.metrological.com

comment "qtbrowser needs qtwebkit or qt5webkit"
	depends on !BR2_PACKAGE_QT_WEBKIT
	depends on !BR2_PACKAGE_QT5WEBKIT
	depends on !BR2_PACKAGE_NRDPLUGIN
```

## package/qttests/Config.in
```kconfig
config BR2_PACKAGE_QTTESTS
	bool "qttests"
	depends on BR2_PACKAGE_QT5
        help
	  Qt tests
```

## package/rpi-armmem/Config.in
```kconfig
config BR2_PACKAGE_RPI_ARMMEM
	bool "rpi-armmem"
	depends on BR2_arm
	help
	  https://github.com/bavison/arm-mem/
```

## package/rpi-nixbrowser/Config.in
```kconfig
config BR2_PACKAGE_RPI_NIXBROWSER
	bool "rpi-nixbrowser"
	depends on BR2_PACKAGE_RPI_USERLAND
	select BR2_PACKAGE_WEBKITNIX
	help
	  Raspberry Pi WebKitNix Browser
```

## package/rpi-server/Config.in
```kconfig
config BR2_PACKAGE_RPI_SERVER
	bool "rpi-server"
	depends on BR2_arm
	depends on BR2_PACKAGE_RPI_FIRMWARE
	depends on BR2_PACKAGE_QTBROWSER
	depends on BR2_PACKAGE_NODEJS
	depends on BR2_PACKAGE_NODEJS_NPM
	help
	  RPI Server
```

## package/rtl8192du/Config.in
```kconfig
config BR2_PACKAGE_RTL8192DU
	bool "rtl8192du"
	depends on BR2_LINUX_KERNEL
	help
	  This package provides various binary firmware files for
	  the RTL8192DU present in the rpistick (rev2) hardware.

	  https://github.com/lwfinger/rtl8192du.git
```

## package/stubs/Config.in
```kconfig
config BR2_PACKAGE_DDPSTUB
	bool "ddpstub"
	help
	  A null implementation of the Dobly Digital Plus interface 
```

## package/tversity-client/Config.in
```kconfig
config BR2_PACKAGE_TVERSITY_CLIENT
	bool "tversity_client"
  depends on BR2_PACKAGE_GSTREAMER1
  depends on BR2_PACKAGE_LIBSOUP
	depends on BR2_PACKAGE_HAS_OPENMAX
	select BR2_PACKAGE_GST1_OMX
	select BR2_PACKAGE_GST1_PLUGINS_BASE
	select BR2_PACKAGE_GST1_PLUGINS_BAD
	select BR2_PACKAGE_GST1_PLUGINS_GOOD
	select BR2_PACKAGE_GST1_PLUGINS_UGLY
	help
	  Client for tversity cloud TV

	  https://github.com/Metrological/tversity-client

  comment "No gstreamer-1.0 found."
		depends on !BR2_PACKAGE_GSTREAMER1

  comment "No lipsoup found."
		depends on !BR2_PACKAGE_LIBSOUP

  comment "No lipopenmax found."
		depends on !BR2_PACKAGE_HAS_OPENMAX

  comment "Not all plugins found"
		depends on !BR2_PACKAGE_GST1_PLUGINS_BASE || !BR2_PACKAGE_GST1_PLUGINS_GOOD || !BR2_PACKAGE_GST1_PLUGINS_BAD || !BR2_PACKAGE_GST1_PLUGINS_UGLY
```
