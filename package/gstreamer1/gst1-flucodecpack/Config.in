## package/gstreamer1/gst1-flucodecpack/Config.in
```kconfig
config BR2_PACKAGE_GST1_FLUCODECPACK
	bool "gst1-flucodecpack"
	depends on BR2_arm
	select BR2_PACKAGE_GST1_PLUGINS_BASE
	select BR2_PACKAGE_LIBCURL
	help
	  GStreamer Fluendo Codec Pack.

	  http://www.metrological.com
```

## package/gstreamer1/gst1-omx/Config.in
```kconfig
config BR2_PACKAGE_GST1_OMX
	bool "gst1-omx"
	depends on BR2_PACKAGE_HAS_OPENMAX
	select BR2_PACKAGE_GST1_PLUGINS_BASE
	help
	  GStreamer plug-in to use OpenMAX API.

	  http://cgit.freedesktop.org/gstreamer/gst-omx

comment "gst1-omx requires a OpenMAX implementation"
	depends on !BR2_PACKAGE_HAS_OPENMAX
```

## package/gstreamer1/gst1-plugins-bcm/Config.in
```kconfig
menuconfig BR2_PACKAGE_GST1_PLUGINS_BCM
        depends on BR2_PACKAGE_BCM_REFSW
        select BR2_PACKAGE_GST1_PLUGINS_BASE
        select BR2_PACKAGE_MPG123
        select BR2_PACKAGE_LIBCURL
        select BR2_PACKAGE_GST1_PLUGINS_BCM_PLUGIN_SYSTEMCLOCK
	bool "gst1-plugins-bcm"
	help
	  Broadcom NEXUS G-Streamer 1.0 plugins

if BR2_PACKAGE_GST1_PLUGINS_BCM

comment "Broadcom Nexus specific plugins"

config BR2_PACKAGE_GST1_PLUGINS_BCM_PLUGIN_AUDFILTER
    bool "audfilter"
    help 
        Add BRCM libbrcmaudiofilter.so    
   
config BR2_PACKAGE_GST1_PLUGINS_BCM_PLUGIN_AUDIODECODE
    bool "audiodecode"
    help 
        Add BRCM libbrcmaudiodecoder.so
 
config BR2_PACKAGE_GST1_PLUGINS_BCM_PLUGIN_AUDIOSINK  
    bool "audiosink"
    help 
        Add BRCM libbrcmaudiosink.so
  
config BR2_PACKAGE_GST1_PLUGINS_BCM_PLUGIN_GFXSINK
    bool "gfxsink"
    help 
        Add BRCM libbrcmgfxsink.so
       
config BR2_PACKAGE_GST1_PLUGINS_BCM_PLUGIN_MP3SWDECODE
    bool "mp3swdecode"
    help 
        Add BRCM libbrcmmp3swdecode.so
       
config BR2_PACKAGE_GST1_PLUGINS_BCM_PLUGIN_PCMSINK
    bool "pcmsink"
    help 
        Add BRCM libbrcmpcmsink.so
     
config BR2_PACKAGE_GST1_PLUGINS_BCM_PLUGIN_PLAYERSINKBIN  
    bool "playersinkbin"
    help 
        Add BRCM libgstplayersinkbin.so

config BR2_PACKAGE_GST1_PLUGINS_BCM_PLUGIN_VIDEODECODE
    bool "videodecode"
    help 
        Add BRCM libbrcmvideodecoder.so
   
config BR2_PACKAGE_GST1_PLUGINS_BCM_PLUGIN_VIDEOSINK     
    bool "videosink"
    help 
        Add BRCM libbrcmvideosink.so
  
config BR2_PACKAGE_GST1_PLUGINS_BCM_PLUGIN_VIDFILTER      
    bool "vidfilter"
    help 
        Add BRCM libbrcmvidfilter.so
        
config BR2_PACKAGE_GST1_PLUGINS_BCM_PLUGIN_HTTPSRC     
    bool "httpsrc"
    help 
        Add BRCM libbrcmhttpsrc.so

config BR2_PACKAGE_GST1_PLUGINS_BCM_PLUGIN_TSDEMUX     
    bool "tsdemux"
    help 
        Add BRCM libbrcmtsdemux.so
        
config BR2_PACKAGE_GST1_PLUGINS_BCM_PLUGIN_TSPARSE     
    bool "tsparse"
    help 
        Add BRCM libbrcmtsparse.so
        
config BR2_PACKAGE_GST1_PLUGINS_BCM_PLUGIN_TRANSCODE     
    bool "transcode"
    help 
        Add BRCM libbrcmtranscode.so
        
config BR2_PACKAGE_GST1_PLUGINS_BCM_PLUGIN_PLAYBACK     
    bool "playback"
    help 
        Add BRCM libbrcmtplayback.so
        
config BR2_PACKAGE_GST1_PLUGINS_BCM_PLUGIN_MP4DEMUX     
    bool "mp4demux"
    help 
        Add BRCM libbrcmmp4demux.so
        
config BR2_PACKAGE_GST1_PLUGINS_BCM_PLUGIN_PCMSINK     
    bool "pcmsync"
    help 
        Add BRCM libbrcmpcmsync.so

endif
```

## package/gstreamer1/gst1-plugins-dlnasrc/Config.in
```kconfig
config BR2_PACKAGE_GST1_PLUGINS_DLNASRC
	bool "gst1-plugins-dlnasrc"
	select BR2_PACKAGE_LIBSOUP
	select BR2_PACKAGE_LIBSOUP_SSL
	select BR2_PACKAGE_GST1_PLUGINS_BASE
	select BR2_PACKAGE_GST1_PLUGINS_GOOD
	select BR2_PACKAGE_GST1_PLUGINS_GOOD_PLUGIN_RTP
	select BR2_PACKAGE_GST1_PLUGINS_GOOD_PLUGIN_RTSP
	help
	  GStreamer plugin for accessing DLNA Media Servers.

	  http://github.com/cablelabs/gst-plugins-dlnasrc
```

## package/gstreamer1/gst1-plugins-dtcpip/Config.in
```kconfig
config BR2_PACKAGE_GST1_PLUGINS_DTCPIP
	bool "gst1-plugins-dtcpip"
	select BR2_PACKAGE_GST1_PLUGINS_BASE
	select BR2_PACKAGE_GST1_PLUGINS_GOOD
	select BR2_PACKAGE_GST1_PLUGINS_GOOD_PLUGIN_RTP
	select BR2_PACKAGE_GST1_PLUGINS_GOOD_PLUGIN_RTSP
	help
	  GStreamer plugin for decrypting DTCP/IP encrypted content.

	  http://github.com/cablelabs/gst-plugins-dtcpip
```

## package/gstreamer1/gst1-plugins-openwebrtc/Config.in
```kconfig
menuconfig BR2_PACKAGE_GST1_PLUGINS_OPENWEBRTC
	bool "gst1-plugins-openwebrtc"
	select BR2_PACKAGE_GST1_PLUGINS_BASE
	select BR2_PACKAGE_LIBUSRSCTP
	select BR2_PACKAGE_GSTREAMER1_GIT
	help
	  GStreamer plugins used by OpenWebRTC.

	  http://openwebrtc.io
```

## package/gstreamer1/gst1-rpicamsrc/Config.in
```kconfig
config BR2_PACKAGE_GST1_RPICAMSRC
	bool "gst1-rpicamsrc"
	depends on BR2_PACKAGE_HAS_OPENMAX
	depends on BR2_PACKAGE_RPI_FIRMWARE_X
	select BR2_PACKAGE_GST1_PLUGINS_BASE
	help
	  GStreamer element for the Raspberry Pi camera module

	  https://github.com/thaytan/gst-rpicamsrc
	  
comment "gst1-rpicamsrc requires BR2_PACKAGE_RPI_FIRMWARE_X"
depends on !BR2_PACKAGE_RPI_FIRMWARE_X
```

## package/gupnp-av/Config.in
```kconfig
config BR2_PACKAGE_GUPNP_AV
	bool "gupnp-av"
	select BR2_PACKAGE_GUPNP
	help
	  GUPnP-AV is a collection of helpers for building AV (audio/video)
	  applications using GUPnP.

	  http://www.gupnp.org
```

## package/gupnp/Config.in
```kconfig
config BR2_PACKAGE_GUPNP
	bool "gupnp"
	select BR2_PACKAGE_GSSDP
	select BR2_PACKAGE_LIBXML2
	select BR2_PACKAGE_UTIL_LINUX_LIBUUID
	help
	  GUPnP implements the UPnP specification: resource announcement
	  and discovery, description, control, event notification, and
	  presentation.

	  http://www.gupnp.org
```

## package/icu/Config.in
```kconfig
config BR2_PACKAGE_ICU
	bool "icu"
	depends on BR2_INSTALL_LIBSTDCPP
	depends on BR2_USE_WCHAR
	depends on BR2_TOOLCHAIN_HAS_THREADS
	# icu does some funky things by generating by itself an ELF
	# file, and it cannot easily be changed to generate FLAT
	# format.
	depends on !BR2_BINFMT_FLAT
	depends on !BR2_arc # atomic builtins
	help
	  International Components for Unicode.

	  http://site.icu-project.org/


if BR2_PACKAGE_ICU

config BR2_PACKAGE_ICU_MINIMIZED
	bool "minimized"
	depends on !BR2_ENABLE_DEBUG

config BR2_ICU_ONLY_COLLATION
	bool "Only collation"

if !BR2_ICU_ONLY_COLLATION

config BR2_ICU_NO_COLLATION
	bool "No collation"

config BR2_ICU_NO_LEGACY_COLLATION
	bool "No legacy collation"

config BR2_ICU_NO_BREAK_ITERATION
	bool "No break iteration"

config BR2_ICU_NO_FORMATTING
	bool "No formatting"

config BR2_ICU_NO_TRANSLITERATION
	bool "No transliteration"

config BR2_ICU_NO_REGULAR_EXPRESSIONS
	bool "No regular expressions"

config BR2_ICU_NO_FILE_IO
	bool "No file IO"

endif

endif


comment "icu needs a toolchain w/ C++, wchar, threads"
	depends on !BR2_arc
	depends on !BR2_BINFMT_FLAT
	depends on !BR2_INSTALL_LIBSTDCPP || !BR2_USE_WCHAR || \
		!BR2_TOOLCHAIN_HAS_THREADS
```

## package/intelce/Config.in
```kconfig
config BR2_PACKAGE_INTELCE
	bool "intelce"
	depends on BR2_i386
	depends on BR2_x86_pentium_m
	help
		Intel CE hardware libraries for the CE3100 platform	

comment "Intel CE requires an i386 pentium mobile architecture"
        depends on !BR2_i386 || !BR2_x86_pentium_m

if BR2_PACKAGE_INTELCE

menu "Libraries"
source "package/intelce/autoeas/Config.in"
source "package/intelce/libraries/libclockcontrol/Config.in"
source "package/intelce/libraries/libflash/Config.in"
source "package/intelce/libraries/libgdl/Config.in"
source "package/intelce/libraries/libgma/Config.in"
source "package/intelce/libraries/libhdmihdcp/Config.in"
source "package/intelce/libraries/libicepm/Config.in"
source "package/intelce/libraries/libidl/Config.in"
source "package/intelce/libraries/libosal/Config.in"
source "package/intelce/libraries/libpal/Config.in"
source "package/intelce/libraries/libplatformconfig/Config.in"
source "package/intelce/libraries/libsec/Config.in"
source "package/intelce/libraries/libsven/Config.in"
source "package/intelce/libraries/libsystemutils/Config.in"
endmenu

#config BR2_PACKAGE_PROVIDES_OPENGL_EGL
#	default "khronos"

#config BR2_PACKAGE_PROVIDES_OPENGL_ES
#	default "khronos"

#config BR2_PACKAGE_PROVIDES_OPENVG
#	default "khronos"

endif
```

## package/intelce/autoeas/Config.in
```kconfig
config BR2_PACKAGE_AUTOEAS
	bool "autoeas"
	help
		Intel CE autoeas tool

#comment "autoeas comments"
```

## package/intelce/libraries/libclockcontrol/Config.in
```kconfig
config BR2_PACKAGE_LIBCLOCK_CONTROL
	bool "libclock-control"
	depends on BR2_TOOLCHAIN_HAS_THREADS
	select BR2_PACKAGE_LIBOSAL
	select BR2_PACKAGE_LIBPAL
	select BR2_PACKAGE_LIBPLATFORM_CONFIG
	select BR2_PACKAGE_LIBSYSTEM_UTILS
	help
		Intel CE Clock Control library

comment "libclock-control requires a toolchain with thread support"
	depends on !BR2_TOOLCHAIN_HAS_THREADS
```

## package/intelce/libraries/libflash/Config.in
```kconfig
config BR2_PACKAGE_LIBFLASH
	bool "libflash"
	depends on BR2_TOOLCHAIN_HAS_THREADS
	select BR2_PACKAGE_LIBOSAL
	help
		Intel CE flash library

#comment "libflash comments"
```

## package/intelce/libraries/libgdl/Config.in
```kconfig
config BR2_PACKAGE_LIBGDL
	bool "libgdl"
	depends on BR2_TOOLCHAIN_HAS_THREADS
	depends on BR2_PACKAGE_OPENSSL
	select BR2_PACKAGE_LIBOSAL
	select BR2_PACKAGE_LIBPAL
	select BR2_PACKAGE_LIBPLATFORM_CONFIG
	select BR2_PACKAGE_LIBSYSTEM_UTILS
	select BR2_PACKAGE_LIBICEPM
	select BR2_PACKAGE_LIBSVEN
	select BR2_PACKAGE_LIBCLOCK_CONTROL
	select BR2_PACKAGE_LIBSEC
	select BR2_PACKAGE_LIBFLASH
	select BR2_PACKAGE_LIBHDMI_HDCP
	select BR2_PACKAGE_LIBIDL
	help
		Intel CE Display library

comment "libgdl requires a toolchain with thread support and openssl support"
	depends on !BR2_TOOLCHAIN_HAS_THREADS || !BR2_PACKAGE_OPENSSL
```

## package/intelce/libraries/libgma/Config.in
```kconfig
config BR2_PACKAGE_LIBGMA
	bool "libgma"
	depends on BR2_TOOLCHAIN_HAS_THREADS
	help
		Intel CE GMA library

comment "libgma requires a toolchain with thread support"
	depends on !BR2_TOOLCHAIN_HAS_THREADS
```

## package/intelce/libraries/libhdmihdcp/Config.in
```kconfig
config BR2_PACKAGE_LIBHDMI_HDCP
	bool "libhdmi-hdcp"
	depends on BR2_TOOLCHAIN_HAS_THREADS
	depends on BR2_PACKAGE_OPENSSL
	select BR2_PACKAGE_LIBOSAL
	select BR2_PACKAGE_LIBPAL
	select BR2_PACKAGE_LIBSEC
	select BR2_PACKAGE_LIBFLASH
	help
		Intel CE HDMI HDCP library

comment "libhdmi-hdcp requires a toolchain with thread support and openssl support"
	depends on !BR2_TOOLCHAIN_HAS_THREADS || !BR2_PACKAGE_OPENSSL
```

## package/intelce/libraries/libicepm/Config.in
```kconfig
config BR2_PACKAGE_LIBICEPM
	bool "libicepm"
	depends on BR2_TOOLCHAIN_HAS_THREADS
	select BR2_PACKAGE_LIBOSAL
	select BR2_PACKAGE_LIBPAL
	select BR2_PACKAGE_LIBPLATFORM_CONFIG
	select BR2_PACKAGE_LIBSYSTEM_UTILS
	help
		Intel CE Power Managment library

comment "libicepm requires a toolchain with thread support"
	depends on !BR2_TOOLCHAIN_HAS_THREADS
```

## package/intelce/libraries/libidl/Config.in
```kconfig
config BR2_PACKAGE_LIBIDL
	bool "libidl"
	depends on BR2_TOOLCHAIN_HAS_THREADS
	select BR2_PACKAGE_LIBOSAL
	help
		Intel CE IDL library

comment "libidl requires a toolchain with thread support"
	depends on !BR2_TOOLCHAIN_HAS_THREADS
```

## package/intelce/libraries/libosal/Config.in
```kconfig
config BR2_PACKAGE_LIBOSAL
	bool "libosal"
	depends on BR2_TOOLCHAIN_HAS_THREADS
	depends on BR2_USE_WCHAR
	help
		Intel CE OSAL library

comment "libosal requires a toolchain with wchar and thread support"
	depends on !BR2_USE_WCHAR || !BR2_TOOLCHAIN_HAS_THREADS
```

## package/intelce/libraries/libpal/Config.in
```kconfig
config BR2_PACKAGE_LIBPAL
	bool "libpal"
	depends on BR2_TOOLCHAIN_HAS_THREADS
	select BR2_PACKAGE_LIBOSAL
	help
		Intel CE PAL library

comment "libpal requires a toolchain with thread support"
	depends on !BR2_TOOLCHAIN_HAS_THREADS
```

## package/intelce/libraries/libplatformconfig/Config.in
```kconfig
config BR2_PACKAGE_LIBPLATFORM_CONFIG
	bool "libplatform-config"
	help
		Intel CE Platform Configuration library

#comment "libplatform-config comments"
```

## package/intelce/libraries/libsec/Config.in
```kconfig
config BR2_PACKAGE_LIBSEC
	bool "libsec"
	help
		Intel CE Security library

#comment "libsec comments"
```

## package/intelce/libraries/libsven/Config.in
```kconfig
config BR2_PACKAGE_LIBSVEN
	bool "libsven"
	select BR2_PACKAGE_AUTOEAS
	select BR2_PACKAGE_LIBOSAL
	select BR2_PACKAGE_LIBPAL
	select BR2_PACKAGE_LIBPLATFORM_CONFIG
	help
		Intel CE SVEN library

#comment "libsven comments"
```
