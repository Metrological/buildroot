## package/v4l-utils/Config.in
```kconfig
config BR2_PACKAGE_V4L_UTILS
	bool "v4l-utils"
	help
	  Provides a series of utilities for media devices, allowing to handle
	  the proprietary formats available at most webcams (libv4l), and
	  providing tools to test V4L devices.

	  It also provides tools to manage the remote controller tables
	  available on most media devices.
```

## package/webbridge/Config.in
```kconfig
config BR2_PACKAGE_WEBBRIDGE
	bool "webbridge"
	depends on BR2_PACKAGE_CPPSDK
	help
	  This application allows plugins to be hosted in a process that 
	  handles webrequest and websockets. 
	  The webrequest and websocket serialization and deserialization
	  are part of the WebBridge. The plugin will receive objects and
	  can send back the objects over a socket connection.

if BR2_PACKAGE_WEBBRIDGE

config BR2_PACKAGE_PLUGIN_FANCONTROL
  bool "fancontrol"
  help
    An example plugin that shows the usage of the webbridge and
	  actually controls a Fan in a household in Holland :-)

config BR2_PACKAGE_PLUGIN_TRACECONTROL
  bool "tracecontrol"
  help
    A plugin that exposes the tracing api over the web interface.
	  Clients can use this interface to enable (and disable) at run-
	  time traces in the process currently running
	  NOTE: Tracing does NOT replace logging but is a tool for 
          developpers to analyse there code. 

config BR2_PACKAGE_PLUGIN_DELAYEDRESPONSE
  bool "delayedresponse"
  help
    A simple echo server to test requests coming form the browser.
	  This echo server is used to test pipelining and concurrency of
    webrequests generated by a browser implementation.

config BR2_PACKAGE_PLUGIN_I2CCONTROL
  bool "i2ccontrol"
  help
    An implementation of a i2c bridge to a web request. Using this plugin
    simple commands can be send from javascript to control a PCF8574 (8 
    bits I/O), a MCP23017 (16 bits I/O) or a DS1621 (temperature sensor).

config BR2_PACKAGE_PLUGIN_SPICONTROL
  bool "spicontrol"
  help
    An implementation of a SPI bridge to a web request. Using this plugin
    simple commands can be send from javascript to control a MCP3002 (10 
    bits dual channel ADC).

config BR2_PACKAGE_PLUGIN_TEMPCONTROL
  bool "tempcontrol"
  help
    An implementation using the 1-Wire kernel module with the temp 1-Wire
    kernel module (Exposing all informatin in the sysfs). Allows for 
    retrieving 1-wire values via the webbridge into the javascript world.

config BR2_PACKAGE_PLUGIN_FILESERVER
  bool "fileserver"
  help
    An implementation of a HTP file server. This module allows for files
    to be uploaded or downloaded using the HTTP sepcification. Downloads
    or uploads can be signed using a symetric key.

config BR2_PACKAGE_PLUGIN_DEVICEINFO
  bool "deviceinfo"
  help
    A plugin displaying information on system resources

config BR2_PACKAGE_PLUGIN_BROWSER
  bool "browser"
	depends on BR2_PACKAGE_QT5WEBKIT
  help
    A plugin that has browser functionality (QtWebKit)

config BR2_PACKAGE_PLUGIN_SURFACECOMPOSITOR
  bool "surfacecompositor"
	depends on BR2_PACKAGE_BCM_REFSW
	select BR2_BCMREFSW_PROXY_MODE
  help
    A nexus platform wrapper to allow multiple processes to
	  access the display and modify properties of the allocated
	  displays. 
	  This module is the refsw_server (only the surface composition
	  part) as found in the Dawn context.

endif
```

## package/webkitgtk-shell/Config.in
```kconfig
config BR2_PACKAGE_WEBKITGTK_SHELL
    bool "webkitgtk-shell"
    depends on BR2_PACKAGE_WEBKITGTK
    help
      WIP. A simple shell for Weston that displays Web content.
```

## package/webkitgtk/Config.in
```kconfig
config BR2_PACKAGE_WEBKITGTK
	bool "webkitgtk"
	depends on BR2_INSTALL_LIBSTDCPP
	depends on BR2_USE_WCHAR
	depends on BR2_TOOLCHAIN_HAS_THREADS
	depends on BR2_PACKAGE_LIBGTK3
	depends on (BR2_arm || BR2_armeb || BR2_i386 || BR2_mips || BR2_mipsel || \
		    BR2_powerpc || BR2_sh || BR2_sparc || BR2_x86_64)
	select BR2_PACKAGE_CAIRO_PNG
	select BR2_PACKAGE_ICU
	select BR2_PACKAGE_LIBXML2
	select BR2_PACKAGE_LIBXSLT
	select BR2_PACKAGE_SQLITE
	select BR2_PACKAGE_ENCHANT
	select BR2_PACKAGE_LIBSOUP
	select BR2_PACKAGE_JPEG
	select BR2_PACKAGE_WEBP
	select BR2_PACKAGE_XLIB_LIBXT if BR2_PACKAGE_XORG7
	help
	  WebKitGtk is an open source, standards compliant web browser engine.

	  Note that WebKitGtk does not build with a toolchain using the
	  old linuxthreads library.

	  http://webkitgtk.org

comment "webkitgtk needs libgtk3 and a toolchain w/ C++, wchar, threads"
	depends on (BR2_arm || BR2_armeb || BR2_i386 || BR2_mips || BR2_mipsel || \
		    BR2_powerpc || BR2_sh || BR2_sparc || BR2_x86_64)
	depends on !BR2_PACKAGE_LIBGTK2 || !BR2_INSTALL_LIBSTDCPP || \
		!BR2_USE_WCHAR || !BR2_TOOLCHAIN_HAS_THREADS
```

## package/webkitnix/Config.in
```kconfig
config BR2_PACKAGE_WEBKITNIX
	bool "webkitnix"
	depends on BR2_INSTALL_LIBSTDCPP
	depends on BR2_USE_WCHAR
	depends on BR2_TOOLCHAIN_HAS_THREADS
	depends on BR2_PACKAGE_HAS_OPENGL_ES
	depends on (BR2_arm || BR2_armeb || BR2_i386 || BR2_mips || BR2_mipsel || \
		    BR2_powerpc || BR2_sh || BR2_sparc || BR2_x86_64)
	select BR2_PACKAGE_ICU
	select BR2_PACKAGE_CAIRO
	select BR2_PACKAGE_CAIRO_PS
	select BR2_PACKAGE_CAIRO_PDF
	select BR2_PACKAGE_CAIRO_PNG
	select BR2_PACKAGE_CAIRO_SVG
	select BR2_PACKAGE_LIBGLIB2
	select BR2_PACKAGE_HARFBUZZ
	select BR2_PACKAGE_JPEG
	select BR2_PACKAGE_LIBSOUP
	select BR2_PACKAGE_LIBXML2
	select BR2_PACKAGE_LIBXSLT
	select BR2_PACKAGE_SQLITE
	help
	  WebKitNix is an open source, standards compliant web browser engine.

	  http://webkitnix.openbossa.org/

comment "webkitnix needs OpenGL ES 2.0 and a toolchain w/ C++, wchar, threads"
	depends on (BR2_arm || BR2_armeb || BR2_i386 || BR2_mips || BR2_mipsel || \
		    BR2_powerpc || BR2_sh || BR2_sparc || BR2_x86_64)
	depends on !BR2_PACKAGE_HAS_OPENGL_ES || !BR2_INSTALL_LIBSTDCPP || \
		!BR2_USE_WCHAR || !BR2_TOOLCHAIN_HAS_THREADS
```

## package/wpe/Config.in
```kconfig
config BR2_PACKAGE_WPE
	bool "wpe"
	select BR2_PACKAGE_CAIRO
	select BR2_PACKAGE_CAIRO_PNG
	select BR2_PACKAGE_FREETYPE
	select BR2_PACKAGE_FONTCONFIG
	select BR2_PACKAGE_GLIB_NETWORKING
	select BR2_PACKAGE_HARFBUZZ
	select BR2_PACKAGE_ICU
	select BR2_PACKAGE_JPEG
	select BR2_PACKAGE_LIBPNG
	select BR2_PACKAGE_LIBXML2
	select BR2_PACKAGE_LIBXSLT
	select BR2_PACKAGE_LIBSOUP
	select BR2_PACKAGE_LIBSOUP_SSL
	select BR2_PACKAGE_LIBGLIB2
	select BR2_PACKAGE_SQLITE
	select BR2_PACKAGE_WEBP
	depends on BR2_PACKAGE_ATHOL || BR2_PACKAGE_WESTON
	help
	  Here be dragons.

menu "Extra options"

config BR2_PACKAGE_WPE_USE_GSTREAMER
	bool "wpe-gstreamer"
	default y
	depends on BR2_PACKAGE_GSTREAMER1
	select BR2_PACKAGE_GST1_PLUGINS_BASE
	select BR2_PACKAGE_GST1_PLUGINS_GOOD
	select BR2_PACKAGE_GST1_PLUGINS_BAD
	select BR2_PACKAGE_GST1_PLUGINS_BAD_PLUGIN_GL
	help
	  Enable GStreamer playback.
comment "wpe-gstreamer requires gstreamer 1.x"
	depends on !BR2_PACKAGE_GSTREAMER1

config BR2_PACKAGE_WPE_USE_GSTREAMER_GL
	bool "gstreamer-gl"
	depends on BR2_PACKAGE_WPE_USE_GSTREAMER
	depends on BR2_PACKAGE_GSTREAMER1_GIT
	default n
	help
	  Use gstreamer-gl video sink for rendering
 
config BR2_PACKAGE_WPE_USE_ENCRYPTED_MEDIA
	bool "encrypted-media"
	select BR2_PACKAGE_OPENSSL
	depends on BR2_PACKAGE_WPE_USE_GSTREAMER
	depends on BR2_PACKAGE_GSTREAMER1_GIT
	default n
	help
	  Enable Encrypted Media Extensions.
comment "encrypted-media requires wpe-gstreamer"
	depends on !BR2_PACKAGE_WPE_USE_GSTREAMER

config BR2_PACKAGE_WPE_USE_DXDRM_EME
	bool "dxdrm-eme"
	default n
	depends on BR2_PACKAGE_WPE_USE_ENCRYPTED_MEDIA
	depends on BR2_PACKAGE_DXDRM
	help
	  Enable Discretix DRM Encrypted Media Extensions backend.
comment "dxdrm-eme requires encrypted-media and dxdrm"
	depends on !BR2_PACKAGE_WPE_USE_ENCRYPTED_MEDIA || !BR2_PACKAGE_DXDRM

config BR2_PACKAGE_WPE_USE_MEDIA_SOURCE
	bool "media-source"
	default n
	depends on BR2_PACKAGE_WPE_USE_GSTREAMER
	help
	  Enable Media Source Extensions API.
comment "media-source requires wpe-gstreamer"
	depends on !BR2_PACKAGE_WPE_USE_GSTREAMER

config BR2_PACKAGE_WPE_USE_THREADED_COMPOSITOR
	bool "threaded-compositor"
	default y
	help
	  Enable threaded compositor

config BR2_PACKAGE_WPE_ENABLE_JS_MEMORY_TRACKING
	bool "js-memory-tracking"
	default n
	help
	  Whether to compile in the javascript memory tracking option (which then needs to be activated with the JSC_showAllocationBacktraces environment variable).

config BR2_PACKAGE_WPE_GENERATE_ECLIPSE_PROJECT
	bool "generate-eclipse-project"
	default n
	help
	  Generate .project file to manage the WPE source code in Eclipse

endmenu
```

## package/x11r7/mesa3d/Config.in
```kconfig
config BR2_PACKAGE_MESA3D
	bool "Mesa 3D Graphics Library"
	select BR2_PACKAGE_XPROTO_GLPROTO
	select BR2_PACKAGE_XLIB_LIBXXF86VM
	select BR2_PACKAGE_XLIB_LIBXDAMAGE
	select BR2_PACKAGE_XLIB_LIBXFIXES
	select BR2_PACKAGE_XPROTO_DRI2PROTO
	select BR2_PACKAGE_LIBDRM
	select BR2_PACKAGE_EXPAT
	select BR2_PACKAGE_HOST_LIBXML2_PYTHON
	select BR2_PACKAGE_HAS_OPENGL_EGL
	select BR2_PACKAGE_HAS_OPENGL_ES
	depends on BR2_PACKAGE_XSERVER_XORG_SERVER_MODULAR
	depends on BR2_INSTALL_LIBSTDCPP
	help
	  Mesa 3D, an open-source implementation of the OpenGL specification.

if BR2_PACKAGE_MESA3D

config BR2_PACKAGE_PROVIDES_OPENGL_ES
	default "mesa3d"

config BR2_PACKAGE_PROVIDES_OPENGL_EGL
	default "mesa3d"

endif
```

## package/xbmc/Config.in
```kconfig
comment "xbmc requires an OpenGL-capable backend"
	depends on !(BR2_PACKAGE_HAS_OPENGL_EGL && BR2_PACKAGE_HAS_OPENGL_ES)

comment "xbmc needs an (e)glibc toolchain w/ C++, wchar"
	depends on !BR2_TOOLCHAIN_USES_GLIBC || !BR2_INSTALL_LIBSTDCPP || !BR2_USE_WCHAR

menuconfig BR2_PACKAGE_XBMC
	bool "xbmc"
	select BR2_NEEDS_HOST_JAVA
	select BR2_PACKAGE_BOOST
	select BR2_PACKAGE_BOOST_THREAD
	select BR2_PACKAGE_BZIP2
	select BR2_PACKAGE_EXPAT
	select BR2_PACKAGE_FLAC
	select BR2_PACKAGE_FONTCONFIG
	select BR2_PACKAGE_FREETYPE
	select BR2_PACKAGE_JASPER
	select BR2_PACKAGE_JPEG
	select BR2_PACKAGE_LIBASS
	select BR2_PACKAGE_LIBCDIO
	select BR2_PACKAGE_LIBCURL
	select BR2_PACKAGE_LIBFRIBIDI
	select BR2_PACKAGE_LIBGCRYPT
	select BR2_PACKAGE_LIBID3TAG
	select BR2_PACKAGE_LIBMAD
	select BR2_PACKAGE_LIBMODPLUG
	select BR2_PACKAGE_LIBMPEG2
	select BR2_PACKAGE_LIBOGG
	select BR2_PACKAGE_LIBPLIST
	select BR2_PACKAGE_LIBPNG
	select BR2_PACKAGE_LIBSAMPLERATE
	select BR2_PACKAGE_LIBUNGIF
	select BR2_PACKAGE_LIBVORBIS
	select BR2_PACKAGE_LIBXML2
	select BR2_PACKAGE_LZO
	select BR2_PACKAGE_NCURSES
	select BR2_PACKAGE_OPENSSL
	select BR2_PACKAGE_PCRE
	select BR2_PACKAGE_PYTHON
	select BR2_PACKAGE_PYTHON_BSDDB
	select BR2_PACKAGE_PYTHON_BZIP2
	select BR2_PACKAGE_PYTHON_CURSES
	select BR2_PACKAGE_PYTHON_PYEXPAT
	select BR2_PACKAGE_PYTHON_READLINE
	select BR2_PACKAGE_PYTHON_SQLITE
	select BR2_PACKAGE_PYTHON_SSL
	select BR2_PACKAGE_PYTHON_UNICODEDATA
	select BR2_PACKAGE_PYTHON_ZLIB
	select BR2_PACKAGE_READLINE
	select BR2_PACKAGE_SQLITE
	select BR2_PACKAGE_TAGLIB
	select BR2_PACKAGE_TIFF
	select BR2_PACKAGE_TINYXML
	select BR2_PACKAGE_YAJL
	select BR2_PACKAGE_ZLIB
	depends on BR2_INSTALL_LIBSTDCPP && BR2_USE_WCHAR && BR2_TOOLCHAIN_USES_GLIBC
	depends on BR2_PACKAGE_HAS_OPENGL_EGL || BR2_PACKAGE_HAS_OPENGL_ES
	help
	  XBMC is an award-winning free and open source (GPL) software
	  media player and entertainment hub for digital media.

	  http://xbmc.org

if BR2_PACKAGE_XBMC

config BR2_PACKAGE_XBMC_AVAHI
	bool "avahi"
	select BR2_PACKAGE_AVAHI
	select BR2_PACKAGE_AVAHI_DAEMON
	help
	  Enable Avahi support.
	  Select this if you want XBMC to support Bonjour protocol.

config BR2_PACKAGE_XBMC_DBUS
	bool "dbus"
	select BR2_PACKAGE_DBUS
	help
	  Enable D-Bus support

config BR2_PACKAGE_XBMC_LIBBLURAY
	bool "libbluray"
	select BR2_PACKAGE_LIBBLURAY
	help
	  Enable Blu-ray input support.
	  Select this if you want to play back Blu-ray content.

config BR2_PACKAGE_XBMC_LIBCEC
	bool "libcec"
	select BR2_PACKAGE_LIBCEC
	depends on BR2_INSTALL_LIBSTDCPP
	depends on BR2_USE_WCHAR
	help
	  Enable CEC (Consumer Electronics Control) support.
	  Select this if you want XBMC to support HDMI CEC.

comment "libcec requires a toolchain w/ C++, wchar support"
	depends on !(BR2_INSTALL_LIBSTDCPP && BR2_USE_WCHAR)

config BR2_PACKAGE_XBMC_LIBMICROHTTPD
	bool "libmicrohttpd"
	select BR2_PACKAGE_LIBMICROHTTPD
	help
	  Enable webserver feature

config BR2_PACKAGE_XBMC_LIBNFS
	bool "libnfs"
	select BR2_PACKAGE_LIBNFS
	depends on BR2_LARGEFILE
	depends on BR2_TOOLCHAIN_HAS_NATIVE_RPC
	help
	  Enable NFS server support.

comment "libnfs support requires a toolchain w/ largefile, RPC support"
	depends on !(BR2_LARGEFILE && BR2_TOOLCHAIN_HAS_NATIVE_RPC)

config BR2_PACKAGE_XBMC_RTMPDUMP
	bool "librtmp"
	select BR2_PACKAGE_RTMPDUMP
	help
	  Enable RTMP input support.
	  Select this if you want to play back rtmp stream.

config BR2_PACKAGE_XBMC_LIBSHAIRPLAY
	bool "libshairport"
	select BR2_PACKAGE_LIBSHAIRPLAY
	depends on BR2_INET_IPV6
	help
	  Enable Shairport support.
	  Select this if you want to stream content from an Apple device.

comment "libshairport support requires a toolchain w/ IPv6 support"
	depends on !(BR2_INET_IPV6)

config BR2_PACKAGE_XBMC_LIBSMBCLIENT
	bool "libsmbclient"
	select BR2_PACKAGE_SAMBA
	select BR2_PACKAGE_SAMBA_LIBSMBCLIENT
	help
	  Enable Samba support

config BR2_PACKAGE_XBMC_LIBTHEORA
	bool "libtheora"
	select BR2_PACKAGE_LIBTHEORA
	help
	  Enable Theora input support.
	  Select this if you want to play back OGG/OGV files (Video).

config BR2_PACKAGE_XBMC_LIBUSB
	bool "libusb"
	depends on BR2_TOOLCHAIN_HAS_THREADS
	select BR2_PACKAGE_LIBUSB
	select BR2_PACKAGE_LIBUSB_COMPAT
	help
	  Enable libusb support.

config BR2_PACKAGE_XBMC_WAVPACK
	bool "wavpack"
	select BR2_PACKAGE_WAVPACK
	help
	  Enable WAV input support.
	  Select this if you want to play back WAV files.

endif
```

## package/xbmc/pvr/Config.in
```kconfig
menuconfig BR2_PACKAGE_PVR
	bool "pvr"
	help
	  XBMC is an award-winning free and open source (GPL) software
	  media player and entertainment hub for digital media.
          This is the repository for PVR addons. These addons enable 
          you to watch live TV in you XBMC.

	  http://xbmc.org

if BR2_PACKAGE_PVR

config BR2_PACKAGE_PVR_TVHEADEND
	bool "TV Headend"
	help
	  Enable TVHeadEnd support
	  Select this if you want XBMC to support a TVHeadEnd backend.

config BR2_PACKAGE_PVR_MYTHTV
	bool "Myth TV"
	help
	  Enable MythTV support
	  Select this if you want XBMC to support a MythTV backend.

endif
```
